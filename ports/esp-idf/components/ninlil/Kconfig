## ports/esp-idf/components/ninlil/Kconfig
```kconfig
menu "Ninlil SX1262 board profile (XIAO ESP32-S3 + Wio-SX1262)"

    config NINLIL_SX1262_PIN_NSS
        int "SX1262 NSS GPIO"
        default 41
        help
            Immutable XIAO ESP32-S3 + Wio-SX1262 profile: GPIO 41.
            Release radio_hil fails compile if this diverges.

    config NINLIL_SX1262_PIN_SCK
        int "SX1262 SCK GPIO"
        default 7
        help
            Target board default: GPIO 7.

    config NINLIL_SX1262_PIN_MOSI
        int "SX1262 MOSI GPIO"
        default 9
        help
            Target board default: GPIO 9.

    config NINLIL_SX1262_PIN_MISO
        int "SX1262 MISO GPIO"
        default 8
        help
            Target board default: GPIO 8.

    config NINLIL_SX1262_PIN_RESET
        int "SX1262 RESET GPIO"
        default 42
        help
            Target board default: GPIO 42.

    config NINLIL_SX1262_PIN_BUSY
        int "SX1262 BUSY GPIO"
        default 40
        help
            Target board default: GPIO 40.

    config NINLIL_SX1262_PIN_DIO1
        int "SX1262 DIO1 GPIO"
        default 39
        help
            Target board default: GPIO 39. ISR latches only; owner task polls.

    config NINLIL_SX1262_PIN_ANT_SW
        int "SX1262 ANT_SW GPIO (-1 if unused)"
        default 38
        help
            Target board default: GPIO 38. Set -1 to disable ANT_SW.

    config NINLIL_SX1262_ANT_SW_ACTIVE_HIGH
        bool "ANT_SW active-high polarity"
        default y
        help
            When enabled, logical active drives the pin high. When disabled,
            active drives low. Ignored if ANT_SW pin is -1.

    config NINLIL_SX1262_SPI_HOST
        int "SPI host id (SPI2_HOST typically 1 on S3)"
        default 1

    config NINLIL_ENABLE_SX1262_R9
        bool "Enable R9 SX1262 physical TX/RX path (Proposed ADR-0025)"
        default n
        help
            Compile R9 physical path TUs: ninlil_sx1262_phy + sx1262_r9_edge.
            Default OFF: zero R9 symbols in default smoke / production archives.

            When enabled (radio_hil_app only in this tree): sole-edge SetTx after
            R1 HAL + R2/R5 permit. Not RF HIL PASS, not Japan legal, not public
            ABI. R4 control-plane (reset/init/SPI deny) remains packaged.

    config NINLIL_RADIO_HIL_SESSION_LEDGER_DIAG
        bool "Diagnostic-only: allow PCP session RAM ledger (NOT release HIL)"
        default n
        depends on NINLIL_ENABLE_SX1262_R9
        help
            Packages pcp_lab_session_ledger and makes radio_hil use it instead
            of flash. Default OFF. V1 release radio_hil MUST use flash only and
            fail closed without accepted FULL durability. Session ledger is
            diagnostic-only and must not appear in release ELF evidence.

            Do not enable for release HIL / power-cut recovery claims.

    config NINLIL_RADIO_HIL_V1_BOARD
        bool "V1 USB/RF board owner"
        default n
        depends on NINLIL_ENABLE_V1_LAB_RADIO_PATH
        help
            Auto-start the fixed USB CDC + single-hop SX1262 V1 board owner.
            The normal target uses the existing flash storage adapter and
            fails closed while FULL durability is unattested. Explicitly
            enabling SESSION_LEDGER_DIAG selects non-durable PSRAM only for
            physical USB/RF bring-up. Neither mode claims legal or field
            acceptance.

    config NINLIL_RADIO_HIL_V1_PEER
        bool "Use generic peer role instead of USB parent"
        default n
        depends on NINLIL_RADIO_HIL_V1_BOARD
        help
            Selects the endpoint opposite controller_side from the first valid
            binding. OFF selects the USB-parent endpoint. Both profiles use the
            same source and adopt their Runtime ID at boot; this is not a
            dynamic role manager or automated Join.

    config NINLIL_RADIO_HIL_NJM1_LAB
        bool "NJM1 three-node automatic Join/relay LAB"
        default n
        depends on NINLIL_ENABLE_SX1262_R9 && !NINLIL_RADIO_HIL_V1_BOARD
        help
            Run the private ADR-0037 LAB state machine over the real R5/R1/R9
            SX1262 path. One common image selects controller/node at runtime
            and supports automatic LAB Join, relay and parent reselection.

            NJM1 is unauthenticated LAB_ONLY traffic. It is not Production
            Attachment, public ABI, RRMP physical acceptance, or legal proof.

endmenu

menu "Ninlil private candidates"

    config NINLIL_ENABLE_PRIVATE_PA_S1_EDHOC
        bool "Enable private PA-S1a EDHOC dependency candidate (not public ABI)"
        default n
        help
            Compile the exact vendored libedhoc/zcbor core slice and the
            bounded explicit-owner allocator. This is default-OFF, private,
            and compile-only on ESP32-S3. No EDHOC crypto provider, carrier,
            credential resolver, Attachment install, Composition connection,
            or HIL claim is included.

    config NINLIL_ENABLE_PRIVATE_PA_S2_EDHOC_CRYPTO
        bool "Enable private PA-S2a EDHOC symmetric/hash candidate"
        depends on NINLIL_ENABLE_PRIVATE_PA_S1_EDHOC
        default n
        help
            Compile the exact libedhoc callback adapter for SHA-256,
            HKDF-SHA-256, suite-2 AES-CCM, and suite-3 ChaCha20-Poly1305.
            This is compile/link/stack evidence only. ESP target KAT,
            Host/ESP equality, P-256 ECDH, credentials, and PA-S2 remain open.

    config NINLIL_ENABLE_PRIVATE_PA_S2B1_EDHOC_P256
        bool "Enable private PA-S2b1 ephemeral P-256 candidate"
        depends on NINLIL_ENABLE_PRIVATE_PA_S2_EDHOC_CRYPTO
        default n
        help
            Compile the exact libedhoc ephemeral P-256 callbacks and opaque
            token bridge. This is compile/link/stack evidence only. Credential
            resolution, static DH, message cleanup owner, target KAT, and PA-S2
            remain open.

    config NINLIL_ENABLE_PRIVATE_PA_S3_NAS1
        bool "Enable private PA-S3a NAS1 direct-stream candidate"
        default n
        help
            Compile/link the fixed 612-byte NAS1 receive buffer and NAC1
            structural validator. This is private compile/link/stack evidence
            only; no socket, credential, EDHOC state, radio, Join, or HIL claim.

    config NINLIL_ENABLE_R7_FRAG_PRIVATE
        bool "Enable private NRW1 LINK/FRAG candidate (not public ABI)"
        default n
        help
            Compile private NRW1 LINK/FRAG sources from the single cmake
            authority cmake/ninlil_r7_frag_sources.cmake into this component.

            Default is disabled: zero FRAG TUs and zero FRAG symbols in the
            installed/public surface and in the default smoke ELF.

            When enabled: private compile/link only. Not OSS public headers,
            not installed ABI, not RF/HIL/legal complete. Physical RF/HIL
            remains a separate gate.

    config NINLIL_ENABLE_V1_LAB_RADIO_PATH
        bool "Enable V1 LAB Fabric-to-SX1262 path (private)"
        depends on NINLIL_ENABLE_R7_FRAG_PRIVATE && NINLIL_ENABLE_SX1262_R9
        default n
        help
            Compile the fixed V1 LAB packet-link that maps one complete NFL1
            ApplicationData or Receipt to NRA1, R7 SINGLE and the sole R9
            SX1262 edge. Maximum two peer pairs and four logical paths.

            This is a private LAB composition, not installed ABI, relay,
            fragmentation, legal certification, or RF HIL evidence.

    config NINLIL_ENABLE_DOMAIN_SCHEMA1_RUNTIME_BINDING
        bool "Enable private Domain schema1 Canonical startup (HOST_CANDIDATE)"
        default n
        help
            Compile ADR-0022 Domain schema1 private TUs and invoke the
            feature-gated runtime create path. Default OFF: zero Domain
            schema1 symbols in production archives.

            HOST_CANDIDATE only: not public ABI, not HIL, not production
            Domain Store complete. Workspace is Runtime-arena owned
            (not ESP task stack). Frames remain <= 4096.

    config NINLIL_ENABLE_PRIVATE_WIFI_V1
        bool "Enable private Wi-Fi v1 candidate (ADR-0018, not public ABI)"
        default n
        help
            Compile private wifi_v1 sources (NWB1/stream/queues/reconnect/
            ESP STA+lwIP+mbedTLS owner). Default OFF: zero wifi_v1 symbols
            in production archives and default smoke ELF.

            Private only: not OSS public headers, not installed ABI, not
            AP/HIL complete. Requires WIFI_STORAGE_RAM STA owner and direct
            mbedTLS (no esp_tls). Hardware AP association remains separate.

    config NINLIL_ENABLE_PRIVATE_FABRIC_V1
        bool "Enable private Fabric v1 (ADR-0017) with Wi-Fi packet-link"
        depends on NINLIL_ENABLE_PRIVATE_WIFI_V1
        default n
        help
            Compile private fabric_v1 headers path and wifi fabric_link_ops
            into the component when Wi-Fi is also ON. Default OFF.

            Not public ABI. Wi-Fi final HIL app may enable this for
            STA+TLS+NWB1+Fabric composition proof. Physical AP remains NOT_RUN.

    config NINLIL_ENABLE_MFDT_V1_PRIVATE
        bool "Enable private ADR-0021 MFDT candidate (not public ABI)"
        default n
        help
            Compile private multi-frame durable transfer sources from
            cmake/ninlil_mfdt_v1_sources.cmake into this component.

            Default is disabled: zero MFDT TUs and zero MFDT symbols in the
            installed/public surface and in the default smoke ELF.

            When enabled: private compile/link only. Not OSS public headers,
            not installed ABI, not power-cut HIL, not RF HIL. Physical H50
            remains a separate hardware residual.

    config NINLIL_ENABLE_PRIVATE_ROUTE_RELAY_V1
        bool "Enable private route-relay / multi-parent candidate (ADR-0019/0020)"
        default n
        help
            Compile private route-relay and multi-parent Host-candidate TUs
            from src/runtime/route_relay_v1/ into this component.

            Default is disabled: zero route-relay/multi-parent symbols in the
            installed/public surface and in the default smoke ELF.

            When enabled: private compile/link only. Not OSS public headers,
            not installed ABI. A single physical node may advertise endpoint
            services and relay concurrently — no fixed single role is encoded.
            Physical 2-hop / multi-parent HIL remains hardware-only residual;
            do not claim RF multi-hop complete without hardware.

    config NINLIL_RRMP_ROLE_ENDPOINT
        bool "Advertise endpoint services when route-relay candidate is enabled"
        depends on NINLIL_ENABLE_PRIVATE_ROUTE_RELAY_V1
        default y
        help
            Role flag only for production composition smoke. Independent of
            relay/parent flags; concurrent with NINLIL_RRMP_ROLE_RELAY.

    config NINLIL_RRMP_ROLE_RELAY
        bool "Enable relay forward path when route-relay candidate is enabled"
        depends on NINLIL_ENABLE_PRIVATE_ROUTE_RELAY_V1
        default n
        help
            Role flag only. May be combined with endpoint and/or parent.

    config NINLIL_RRMP_ROLE_PARENT
        bool "Enable multi-parent owner path when route-relay candidate is enabled"
        depends on NINLIL_ENABLE_PRIVATE_ROUTE_RELAY_V1
        default n
        help
            Role flag only. May be combined with endpoint and/or relay.

endmenu
```

## ports/esp-idf/smoke_app/sdkconfig.defaults.pa_s2b1_edhoc_p256_on
```kconfig
CONFIG_NINLIL_ENABLE_PRIVATE_PA_S1_EDHOC=y
CONFIG_NINLIL_ENABLE_PRIVATE_PA_S2_EDHOC_CRYPTO=y
CONFIG_NINLIL_ENABLE_PRIVATE_PA_S2B1_EDHOC_P256=y
CONFIG_MBEDTLS_CCM_C=y
CONFIG_MBEDTLS_CHACHA20_C=y
CONFIG_MBEDTLS_POLY1305_C=y
CONFIG_MBEDTLS_CHACHAPOLY_C=y
CONFIG_MBEDTLS_ECP_C=y
CONFIG_MBEDTLS_ECDH_C=y
CONFIG_MBEDTLS_ECP_DP_SECP256R1_ENABLED=y
```

## ports/esp-idf/smoke_app/sdkconfig.defaults.v1_lab_radio_path_on
```kconfig
CONFIG_NINLIL_ENABLE_SX1262_R9=y
CONFIG_NINLIL_ENABLE_R7_FRAG_PRIVATE=y
CONFIG_NINLIL_ENABLE_V1_LAB_RADIO_PATH=y
```
