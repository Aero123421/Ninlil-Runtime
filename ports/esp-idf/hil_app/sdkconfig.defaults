## ports/esp-idf/hil_app/sdkconfig.defaults
```kconfig
CONFIG_COMPILER_OPTIMIZATION_SIZE=y
CONFIG_PARTITION_TABLE_CUSTOM=y
CONFIG_PARTITION_TABLE_CUSTOM_FILENAME="../partitions/ninlil_storage.csv"
CONFIG_PARTITION_TABLE_FILENAME="../partitions/ninlil_storage.csv"
CONFIG_ESPTOOLPY_FLASHSIZE_8MB=y
CONFIG_WL_SECTOR_SIZE_4096=y
CONFIG_WL_SECTOR_SIZE=4096
CONFIG_SPIRAM=y
CONFIG_SPIRAM_MODE_OCT=y
CONFIG_SPIRAM_SPEED_80M=y
CONFIG_SPIRAM_USE_CAPS_ALLOC=y

# U2: control CDC enabled for link of A2 adapter symbols; console stays UART.
CONFIG_TINYUSB_CDC_ENABLED=y
CONFIG_TINYUSB_CDC_COUNT=1

# R7 component consumer requirement. This only enables target compile/link;
# it does not turn the storage power-cut app into an R7 device/HIL verdict.
CONFIG_MBEDTLS_HKDF_C=y
```

## ports/esp-idf/smoke_app/sdkconfig.defaults
```kconfig
# Combined owner/cell + durable-storage smoke.
# compile/link ≠ HIL PASS / dual-core race PASS / physical power-cut HIL.
# Does not claim field-ready.
#
# Partition CSV paths are relative to the ESP-IDF *project directory*
# (this smoke_app/). Real file: ports/esp-idf/partitions/ninlil_storage.csv
# => from smoke_app use ../partitions/... (NOT ../../partitions/...).

CONFIG_COMPILER_OPTIMIZATION_SIZE=y
CONFIG_FREERTOS_UNICORE=n
CONFIG_FREERTOS_CHECK_PORT_CRITICAL_COMPLIANCE=y
CONFIG_ESP_TIMER_SUPPORTS_ISR_DISPATCH_METHOD=y

CONFIG_PARTITION_TABLE_CUSTOM=y
CONFIG_PARTITION_TABLE_CUSTOM_FILENAME="../partitions/ninlil_storage.csv"
CONFIG_PARTITION_TABLE_FILENAME="../partitions/ninlil_storage.csv"
CONFIG_ESPTOOLPY_FLASHSIZE_8MB=y

# Raw Ninlil images are 4 KiB aligned. 4096-byte WL sectors avoid the
# 512-byte performance-mode power-loss window and minimize write amplification.
CONFIG_WL_SECTOR_SIZE_4096=y
CONFIG_WL_SECTOR_SIZE=4096

# Production storage workspace requires PSRAM (docs/21).
# CAPS alloc for heap_caps_malloc(MALLOC_CAP_SPIRAM). The workspace is not
# linked into external BSS/DATA, so segment-placement Kconfig is unnecessary.
CONFIG_SPIRAM=y
CONFIG_SPIRAM_MODE_OCT=y
CONFIG_SPIRAM_SPEED_80M=y
CONFIG_SPIRAM_USE_CAPS_ALLOC=y

# U2: dedicated control CDC-ACM on USB OTG Device (esp_tinyusb).
# Console/logging stays on UART — do NOT enable CDC console redirection.
CONFIG_TINYUSB_CDC_ENABLED=y
CONFIG_TINYUSB_CDC_COUNT=1
# Explicit non-claim: control CDC must never receive printf/ESP_LOG.
# Leave any CDC console / VFS stdio redirect options OFF (default).
```
