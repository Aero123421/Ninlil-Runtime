/*
 * D3-S2 production crossrow bridge (append-only sibling oracle):
 * executes the D3-S2 suffix vectors from domain-scan-crossrow-v1 through
 * real production begin_profiled_d3s2 + d3s2_drive + finalize/abort against
 * scripted Storage Port rows, then compares status, phase, count/binding
 * masks, sticky, adopted, D2 counters, mutation_calls=0, and exact Port
 * trace against the independent oracle fixture.
 *
 * Suffix inventory (not D3-S2 complete):
 *   - 6 Mode21..26 empty-carrier/empty-secondary COMPLETE smoke
 *   - Mode25 CUM total=1 + RECENT C1 + true ANCHOR COMPLETE success
 *   - Mode25 RECENT-without-CUM BIND carrier-ABSENT STORAGE_CORRUPT (note)
 *   - Mode26 ES resume=1 + MANAGEMENT RESUME + true ANCHOR COMPLETE success
 *   - Mode26 MANAGEMENT-without-ES BIND carrier-ABSENT STORAGE_CORRUPT (note)
 *   - Mode24 RC reply_count=1 + RR RECEIPT + true DELIVERY COMPLETE success
 *   - Mode24 RR-without-RC BIND carrier-ABSENT STORAGE_CORRUPT (note)
 *   - Mode23 TX STATE + ANCHOR + EVIDENCE slots 0..L equation COMPLETE success
 *   - Mode23 EVIDENCE-without-STATE BIND carrier-ABSENT STORAGE_CORRUPT (note)
 *   - Mode22 RC app=1 + DLV-owned ATTEMPT + true DELIVERY COMPLETE success
 *   - Mode22 ATTEMPT-without-RC BIND carrier-ABSENT STORAGE_CORRUPT (note)
 *   - Mode21 STATE cum=1 + TX ATT + AII + true ANCHOR COMPLETE success
 *   - Mode21 ATT-without-AII (CP PRESENT) BIND INDEX pair-ABSENT CORRUPT
 *   - P0-A Mode25 two-owner SHA RETRY interleave + dual CUM carrier COMPLETE
 *   - P0-B Mode26 mid-FOCUS budget stop + same-iterator resume (case13 B5/B6)
 *   - P0-C Mode25 BIND exact_get Port IO_ERROR → STORAGE / FAILED / sticky
 *     STORAGE / incomplete BIND mask / exact Port-trace (H3; no fabricated
 *     CORRUPT outcome). JSON note_count is formal reference-model only
 *     (generator/check); this bridge does not count note_terminal_corrupt.
 *   - P0-D Mode22 unexpected ATTEMPT_ID_INDEX PRESENT (BIND pair ABSENT-peer
 *     fail after carrier+primary); Mode22 true-primary DELIVERY ABSENT;
 *     Mode21 primary PVD mismatch; Mode21 INDEX pair subject/raw mismatch
 *     (pair residual only — true-primary raw unconstructible under D1).
 *     Mode21 success BIND_INDEX no-STATE companion re-get is pinned by
 *     d3_peer_get_count + exact Port-trace (existing success vector).
 *   - P1-A ordinary stream under/over + empty-secondary undercount (case4/14)
 *   - P1-D Mode21 profile_mismatch / future_profile evaluator-off (case12)
 *   - P1-D2 Mode21 count-green without BIND set (case10): call checkpoint at
 *     BIND_ATTEMPT with count_complete full / binding_complete 0; test-only
 *     probe_false_terminal_finalize on session/context copy (EXHAUSTED)
 *     expects INVALID_STATE Port0 no mutation; original resumes COMPLETE.
 *   - P1-B1 Mode22 CLEANUP ordinary-skip + Mode23 still-ordinary (case5)
 *   - P1-B2 Mode24/25/26 CLEANUP PRESENT still-ordinary negatives (case5
 *     residual): cleanup_skip=0, phase FAILED, sticky CORRUPT, no CLEANUP
 *     setup get; real production checkpoint + Port-trace.
 *
 * Fixture is generated by tools/domain_scan_crossrow_d3s2_vector_gen.py
 * emit-c-fixture (no production C translation / no manual expected values).
 * Does NOT #include production unit-test .c sources.
 * Does NOT claim full D3-S2 oracle complete.
 * Stage5 D3 remains unbound. D3-S1 94-vector bridge is separate.
 */

#include "domain_store_d3s2.h"
#include "domain_store_scanner.h"
#include "scripted_storage_spy.h"

#include "domain_scan_crossrow_vector_fixture.h"

#include <stdio.h>
#include <string.h>

#define REQUIRE(condition)                                                     \
    do {                                                                       \
        if (!(condition)) {                                                    \
            (void)fprintf(stderr, "%s:%d: %s failed: %s\n", __FILE__,          \
                __LINE__, current_id, #condition);                             \
            return 1;                                                          \
        }                                                                      \
    } while (0)

static const char *current_id = "";

static ninlil_status_t status_from_name(const char *name)
{
    if (strcmp(name, "OK") == 0) {
        return NINLIL_OK;
    }
    if (strcmp(name, "INVALID_ARGUMENT") == 0) {
        return NINLIL_E_INVALID_ARGUMENT;
    }
    if (strcmp(name, "UNSUPPORTED") == 0) {
        return NINLIL_E_UNSUPPORTED;
    }
    if (strcmp(name, "STORAGE") == 0) {
        return NINLIL_E_STORAGE;
    }
    if (strcmp(name, "STORAGE_CORRUPT") == 0) {
        return NINLIL_E_STORAGE_CORRUPT;
    }
    if (strcmp(name, "STORAGE_COMMIT_UNKNOWN") == 0) {
        return NINLIL_E_STORAGE_COMMIT_UNKNOWN;
    }
    if (strcmp(name, "INVALID_STATE") == 0) {
        return NINLIL_E_INVALID_STATE;
    }
    if (strcmp(name, "WOULD_BLOCK") == 0) {
        return NINLIL_E_WOULD_BLOCK;
    }
    if (strcmp(name, "CAPACITY_EXHAUSTED") == 0) {
        return NINLIL_E_CAPACITY_EXHAUSTED;
    }
    return (ninlil_status_t)0xFFFFu;
}

static ninlil_domain_scan_state_t state_from_name(const char *name)
{
    if (strcmp(name, "IDLE") == 0) {
        return NINLIL_DOMAIN_SCAN_STATE_IDLE;
    }
    if (strcmp(name, "OPEN") == 0) {
        return NINLIL_DOMAIN_SCAN_STATE_OPEN;
    }
    if (strcmp(name, "EXHAUSTED") == 0) {
        return NINLIL_DOMAIN_SCAN_STATE_EXHAUSTED;
    }
    if (strcmp(name, "FAILED") == 0) {
        return NINLIL_DOMAIN_SCAN_STATE_FAILED;
    }
    if (strcmp(name, "DONE") == 0) {
        return NINLIL_DOMAIN_SCAN_STATE_DONE;
    }
    return (ninlil_domain_scan_state_t)0xFFu;
}

static ninlil_spy_op_t spy_op_from_name(const char *name)
{
    if (strcmp(name, "begin") == 0) {
        return NINLIL_SPY_OP_BEGIN;
    }
    if (strcmp(name, "get") == 0) {
        return NINLIL_SPY_OP_GET;
    }
    if (strcmp(name, "iter_open") == 0) {
        return NINLIL_SPY_OP_ITER_OPEN;
    }
    if (strcmp(name, "iter_next") == 0) {
        return NINLIL_SPY_OP_ITER_NEXT;
    }
    if (strcmp(name, "rollback") == 0) {
        return NINLIL_SPY_OP_ROLLBACK;
    }
    return NINLIL_SPY_OP_COUNT;
}

static ninlil_spy_shape_t shape_from_name(const char *name)
{
    if (strcmp(name, "bts") == 0) {
        return NINLIL_SPY_SHAPE_BTS_LENGTHS;
    }
    if (strcmp(name, "unknown") == 0) {
        return NINLIL_SPY_SHAPE_NATURAL;
    }
    if (strcmp(name, "natural") == 0) {
        return NINLIL_SPY_SHAPE_NATURAL;
    }
    return NINLIL_SPY_SHAPE_NATURAL;
}

static ninlil_storage_status_t status_for_fault(const ninlil_d3s2_fault_t *f)
{
    if (strcmp(f->shape, "unknown") == 0
        || strcmp(f->status, "UNKNOWN_RAW") == 0) {
        return (ninlil_storage_status_t)99u;
    }
    if (strcmp(f->status, "IO_ERROR") == 0) {
        return NINLIL_STORAGE_IO_ERROR;
    }
    if (strcmp(f->status, "BUSY") == 0) {
        return NINLIL_STORAGE_BUSY;
    }
    if (strcmp(f->status, "CORRUPT") == 0) {
        return NINLIL_STORAGE_CORRUPT;
    }
    if (strcmp(f->status, "UNSUPPORTED_SCHEMA") == 0) {
        return NINLIL_STORAGE_UNSUPPORTED_SCHEMA;
    }
    if (strcmp(f->status, "COMMIT_UNKNOWN") == 0) {
        return NINLIL_STORAGE_COMMIT_UNKNOWN;
    }
    if (strcmp(f->status, "NO_SPACE") == 0) {
        return NINLIL_STORAGE_NO_SPACE;
    }
    return NINLIL_STORAGE_OK;
}

static int map_spy_op_to_oracle_name(ninlil_spy_op_t op, const char **out_name)
{
    switch (op) {
    case NINLIL_SPY_OP_BEGIN:
        *out_name = "begin:READ_ONLY";
        return 1;
    case NINLIL_SPY_OP_GET:
        *out_name = "get";
        return 1;
    case NINLIL_SPY_OP_ITER_OPEN:
        *out_name = "iter_open:prefix0";
        return 1;
    case NINLIL_SPY_OP_ITER_NEXT:
        *out_name = "iter_next";
        return 1;
    case NINLIL_SPY_OP_ITER_CLOSE:
        *out_name = "iter_close";
        return 1;
    case NINLIL_SPY_OP_ROLLBACK:
        *out_name = "rollback";
        return 1;
    case NINLIL_SPY_OP_CLOSE:
        *out_name = "close";
        return 1;
    case NINLIL_SPY_OP_OPEN:
        *out_name = "open";
        return 1;
    case NINLIL_SPY_OP_PUT:
        *out_name = "put";
        return 1;
    case NINLIL_SPY_OP_ERASE:
        *out_name = "erase";
        return 1;
    case NINLIL_SPY_OP_CAPACITY:
        *out_name = "capacity";
        return 1;
    case NINLIL_SPY_OP_COMMIT:
        *out_name = "commit";
        return 1;
    default:
        *out_name = "unknown_enum";
        return 0;
    }
}

/*
 * Count S2 peer/FOCUS/BIND exact_gets from Port-trace: gets after the first
 * iter_open. Baseline profile gate (17 gets before any iter_open) is excluded
 * without magic subtraction from spy totals — the begin/baseline boundary is
 * the first iter_open in the mapped oracle-equivalent trace.
 */
static uint64_t count_peer_gets_from_trace(
    const char *const *mapped, size_t mapped_count)
{
    uint64_t peer = 0u;
    int after_iter_open = 0;
    size_t i;

    for (i = 0u; i < mapped_count; ++i) {
        if (strcmp(mapped[i], "begin:READ_ONLY") == 0) {
            after_iter_open = 0;
        } else if (strcmp(mapped[i], "iter_open:prefix0") == 0) {
            after_iter_open = 1;
        } else if (after_iter_open != 0 && strcmp(mapped[i], "get") == 0) {
            peer += 1u;
        }
    }
    return peer;
}

static void fill_candidate(
    ninlil_model_runtime_store_binding_t *out,
    const ninlil_d3s2_binding_t *in)
{
    (void)memset(out, 0, sizeof(*out));
    out->storage_schema = in->storage_schema;
    out->role = (ninlil_role_t)in->role;
    out->environment = (ninlil_environment_t)in->environment;
    (void)memcpy(out->runtime_id.bytes, in->runtime_id, 16u);
    out->limits.max_services = in->max_services;
    out->limits.max_nonterminal_transactions =
        in->max_nonterminal_transactions;
    out->limits.max_targets_per_transaction =
        in->max_targets_per_transaction;
    out->limits.max_logical_payload_bytes = in->max_logical_payload_bytes;
    out->limits.max_durable_outbox_payload_bytes =
        in->max_durable_outbox_payload_bytes;
    out->limits.max_attempts_per_target_per_cycle =
        in->max_attempts_per_target_per_cycle;
    out->limits.max_cancel_attempts_per_transaction =
        in->max_cancel_attempts_per_transaction;
    out->limits.max_evidence_per_target = in->max_evidence_per_target;
    out->limits.max_retained_terminal_transactions =
        in->max_retained_terminal_transactions;
    out->limits.max_nonterminal_deliveries = in->max_nonterminal_deliveries;
    out->limits.max_event_spool_count = in->max_event_spool_count;
    out->limits.max_event_spool_bytes = in->max_event_spool_bytes;
    out->limits.max_result_cache_entries = in->max_result_cache_entries;
    out->limits.max_retained_dispositions = in->max_retained_dispositions;
    out->limits.max_ingress_per_step = in->max_ingress_per_step;
    out->limits.max_callbacks_per_step = in->max_callbacks_per_step;
    out->limits.max_state_transitions_per_step =
        in->max_state_transitions_per_step;
    out->limits.max_bearer_sends_per_step = in->max_bearer_sends_per_step;
    out->limits.max_deferred_tokens = in->max_deferred_tokens;
    out->terminal_retention_ms = in->terminal_retention_ms;
    out->result_cache_retention_ms = in->result_cache_retention_ms;
    out->observation_retention_ms = in->observation_retention_ms;
}

static int install_rows(
    ninlil_scripted_storage_spy_t *spy,
    const ninlil_d3s2_row_t *rows,
    size_t row_count)
{
    size_t i;
    for (i = 0u; i < row_count; ++i) {
        if (!ninlil_spy_add_row(spy, rows[i].key, rows[i].key_length,
                rows[i].value_length == 0u ? NULL : rows[i].value,
                rows[i].value_length)) {
            return 0;
        }
    }
    return 1;
}

static uint64_t decode_u64_be_lane(const uint8_t lane[8])
{
    return ((uint64_t)lane[0] << 56) | ((uint64_t)lane[1] << 48)
        | ((uint64_t)lane[2] << 40) | ((uint64_t)lane[3] << 32)
        | ((uint64_t)lane[4] << 24) | ((uint64_t)lane[5] << 16)
        | ((uint64_t)lane[6] << 8) | (uint64_t)lane[7];
}

/*
 * Call-level production context + spy checkpoint (P0-B). Compares only when
 * has_checkpoint!=0; existing calls ship has_checkpoint=0 and are unchanged.
 */
static int compare_call_checkpoint(const ninlil_d3s2_call_t *call,
    const ninlil_domain_scan_d3s2_context_t *ctx,
    const ninlil_scripted_storage_spy_t *spy)
{
    uint8_t focus_live;
    if (call->has_checkpoint == 0u) {
        return 0;
    }
    REQUIRE(ctx != NULL);
    REQUIRE(spy != NULL);
    REQUIRE(call->cp_last_carrier_key_len > 0u);
    REQUIRE(ctx->phase == call->cp_phase);
    focus_live =
        (uint8_t)((ctx->flags & NINLIL_DOMAIN_SCAN_D3S2_FLAG_FOCUS_LIVE) != 0u
                ? 1u
                : 0u);
    REQUIRE(focus_live == call->cp_focus_live);
    REQUIRE(decode_u64_be_lane(ctx->observed_a) == call->cp_observed_a);
    REQUIRE(decode_u64_be_lane(ctx->observed_b) == call->cp_observed_b);
    REQUIRE(decode_u64_be_lane(ctx->observed_c) == call->cp_observed_c);
    REQUIRE(ctx->count_complete_mask == call->cp_count_complete_mask);
    REQUIRE(ctx->binding_complete_mask == call->cp_binding_complete_mask);
    REQUIRE(ctx->flags == call->cp_flags);
    REQUIRE((ctx->flags & NINLIL_DOMAIN_SCAN_D3S2_FLAG_COMPLETE_READY) == 0u);
    REQUIRE(ctx->pass_kind == call->cp_pass_kind);
    REQUIRE(ctx->cleanup_skip == call->cp_cleanup_skip);
    REQUIRE(ctx->last_carrier_key_len == call->cp_last_carrier_key_len);
    if (call->cp_last_carrier_key != NULL) {
        REQUIRE(memcmp(ctx->last_carrier_key, call->cp_last_carrier_key,
                    call->cp_last_carrier_key_len)
            == 0);
    }
    REQUIRE(spy->begin_calls == call->cp_begin_calls);
    REQUIRE(spy->iter_open_calls == call->cp_iter_open_calls);
    REQUIRE(spy->iter_close_calls == call->cp_iter_close_calls);
    REQUIRE(spy->trace_count == call->cp_trace_count);
    /* Same session/txn still live; no B11 restart. */
    REQUIRE(spy->begin_calls == 1u);
    return 0;
}

static int run_vector(const ninlil_d3s2_vector_t *vec)
{
    ninlil_scripted_storage_spy_t spy;
    ninlil_domain_scan_session_t session;
    ninlil_domain_scan_workspace_t workspace;
    ninlil_domain_scan_d3s2_context_t d3s2_context;
    ninlil_domain_scan_result_t result;
    ninlil_model_runtime_store_binding_t candidate;
    ninlil_storage_handle_t handle;
    const ninlil_storage_ops_t *ops;
    ninlil_status_t status = NINLIL_OK;
    ninlil_status_t expected_final;
    size_t i;
    size_t mapped_trace = 0u;
    const char *mapped[NINLIL_D3S2_MAX_TRACE];
    const char *last_op;
    uint32_t begin_calls_seen = 0u;
    int expect_complete;
    int expect_evaluator_off;
    uint64_t observed_get_total;
    uint64_t observed_peer_gets;
    uint64_t baseline_gets;

    current_id = vec->id;
    expected_final = status_from_name(vec->expected.final_status);
    /*
     * Three closed branches from expected profile diagnostics + phase
     * (no dedicated boolean): ordinary COMPLETE/adopt1; sticky FAILED;
     * evaluator-off terminal candidate (BASELINE + mismatch|future →
     * UNSUPPORTED/adopt0). Candidate is never treated as COMPLETE or FAILED.
     */
    expect_evaluator_off =
        (vec->expected.profile_exact_active == 0u
            && (vec->expected.profile_mismatch != 0u
                || vec->expected.future_profile_candidate != 0u)
            && vec->expected.phase == NINLIL_DOMAIN_SCAN_D3S2_PHASE_BASELINE
            && expected_final == NINLIL_E_UNSUPPORTED
            && vec->expected.adopted == 0u);
    expect_complete =
        (vec->expected.phase == NINLIL_DOMAIN_SCAN_D3S2_PHASE_COMPLETE
            && !expect_evaluator_off);

    ninlil_spy_init(&spy);
    ops = ninlil_spy_ops(&spy);
    handle = ninlil_spy_open_handle(&spy);
    fill_candidate(&candidate, &vec->candidate);

    REQUIRE(install_rows(&spy, vec->rows, vec->row_count));
    for (i = 0u; i < vec->fault_count; ++i) {
        const ninlil_d3s2_fault_t *f = &vec->faults[i];
        ninlil_spy_op_t op = spy_op_from_name(f->op);
        REQUIRE(op < NINLIL_SPY_OP_COUNT);
        REQUIRE(ninlil_spy_add_fault(&spy, op, f->on_call, status_for_fault(f),
            shape_from_name(f->shape), f->key_length, f->value_length));
    }

    ninlil_domain_scan_session_init(&session);
    (void)memset(&workspace, 0, sizeof(workspace));
    (void)memset(&d3s2_context, 0, sizeof(d3s2_context));
    (void)memset(&result, 0, sizeof(result));

    for (i = 0u; i < vec->call_count; ++i) {
        const ninlil_d3s2_call_t *call = &vec->calls[i];
        uint64_t trace_before = spy.trace_count;
        REQUIRE(call->expected_status != NULL);

        if (strcmp(call->op, "begin_profiled_d3s2") == 0) {
            ninlil_domain_scan_d3s2_context_t *ctx_arg = &d3s2_context;
            if (call->context != NULL
                && strcmp(call->context, "null") == 0) {
                ctx_arg = NULL;
            } else if (call->context != NULL
                && strcmp(call->context, "alias_session") == 0) {
                ctx_arg =
                    (ninlil_domain_scan_d3s2_context_t *)(void *)&session;
            }
            status = ninlil_domain_scan_begin_profiled_d3s2(
                &session, ops, &handle, &workspace, &candidate, call->mode,
                ctx_arg);
            REQUIRE(status == status_from_name(call->expected_status));
            if (status == NINLIL_OK) {
                /* bound_d3_context / bound_d3s2_context are a union; kind is
                 * the exclusive discriminator (dual-bound forbidden). */
                REQUIRE(session.bound_d3_kind == NINLIL_DOMAIN_SCAN_D3_KIND_S2);
                REQUIRE(session.bound_d3s2_context == &d3s2_context);
                REQUIRE(d3s2_context.focus_mode == call->mode);
                REQUIRE(d3s2_context.focus_mode == vec->mode);
                begin_calls_seen += 1u;
            } else {
                REQUIRE(spy.trace_count == trace_before);
            }
            if (compare_call_checkpoint(call, &d3s2_context, &spy) != 0) {
                return 1;
            }
        } else if (strcmp(call->op, "d3s2_drive") == 0) {
            status = ninlil_domain_scan_d3s2_drive(&session, call->row_budget);
            REQUIRE(status == status_from_name(call->expected_status));
            if (compare_call_checkpoint(call, &d3s2_context, &spy) != 0) {
                return 1;
            }
        } else if (strcmp(call->op, "finalize") == 0) {
            status = ninlil_domain_scan_finalize(&session, &result);
            REQUIRE(status == status_from_name(call->expected_status));
            if (compare_call_checkpoint(call, &d3s2_context, &spy) != 0) {
                return 1;
            }
        } else if (strcmp(call->op, "abort") == 0) {
            status = ninlil_domain_scan_abort(&session, &result);
            REQUIRE(status == status_from_name(call->expected_status));
            if (compare_call_checkpoint(call, &d3s2_context, &spy) != 0) {
                return 1;
            }
        } else if (strcmp(call->op, "probe_false_terminal_finalize") == 0) {
            /*
             * Test-only false-terminal probe (§18.13.15 case10): copy
             * session+context, force EXHAUSTED so the incomplete COMPLETE
             * gate runs (not mere OPEN-state reject). Original live
             * session/context/result and Port spy must be unchanged.
             */
            ninlil_domain_scan_session_t session_copy;
            ninlil_domain_scan_d3s2_context_t context_copy;
            ninlil_domain_scan_result_t result_probe;
            ninlil_domain_scan_result_t result_canary;
            uint8_t session_canary[sizeof(session)];
            uint8_t context_canary[sizeof(d3s2_context)];
            uint8_t session_copy_canary[sizeof(session_copy)];
            uint8_t context_copy_canary[sizeof(context_copy)];
            uint64_t spy_before = spy.trace_count;

            (void)memcpy(&session_copy, &session, sizeof(session_copy));
            (void)memcpy(&context_copy, &d3s2_context, sizeof(context_copy));
            (void)memcpy(session_canary, &session, sizeof(session));
            (void)memcpy(context_canary, &d3s2_context, sizeof(d3s2_context));
            (void)memset(&result_probe, 0xA5, sizeof(result_probe));
            (void)memcpy(&result_canary, &result_probe, sizeof(result_canary));

            session_copy.bound_d3s2_context = &context_copy;
            session_copy.state = NINLIL_DOMAIN_SCAN_STATE_EXHAUSTED;
            (void)memcpy(
                session_copy_canary, &session_copy, sizeof(session_copy));
            (void)memcpy(
                context_copy_canary, &context_copy, sizeof(context_copy));

            /* Count green + BIND incomplete + no sticky + not COMPLETE. */
            REQUIRE(context_copy.count_complete_mask
                == ninlil_domain_scan_d3s2_required_count_mask(
                    context_copy.focus_mode));
            REQUIRE((context_copy.binding_complete_mask
                        & ninlil_domain_scan_d3s2_required_binding_mask(
                            context_copy.focus_mode))
                != ninlil_domain_scan_d3s2_required_binding_mask(
                    context_copy.focus_mode));
            REQUIRE(context_copy.phase
                == NINLIL_DOMAIN_SCAN_D3S2_PHASE_BIND_ATTEMPT);
            REQUIRE((context_copy.flags
                        & NINLIL_DOMAIN_SCAN_D3S2_FLAG_COMPLETE_READY)
                == 0u);
            REQUIRE(session_copy.has_sticky_primary == 0u);

            status = ninlil_domain_scan_finalize(
                &session_copy, &result_probe);
            REQUIRE(status == status_from_name(call->expected_status));
            REQUIRE(status == NINLIL_E_INVALID_STATE);
            REQUIRE(spy.trace_count == spy_before); /* Port 0 */
            REQUIRE(memcmp(&session, session_canary, sizeof(session)) == 0);
            REQUIRE(memcmp(&d3s2_context, context_canary, sizeof(d3s2_context))
                == 0);
            REQUIRE(memcmp(
                        &session_copy, session_copy_canary, sizeof(session_copy))
                == 0);
            REQUIRE(memcmp(
                        &context_copy, context_copy_canary, sizeof(context_copy))
                == 0);
            REQUIRE(memcmp(&result_probe, &result_canary, sizeof(result_probe))
                == 0);
            REQUIRE(session_copy.state == NINLIL_DOMAIN_SCAN_STATE_EXHAUSTED);
            REQUIRE(session.state == NINLIL_DOMAIN_SCAN_STATE_OPEN);
        } else {
            REQUIRE(0);
        }
    }

    REQUIRE(begin_calls_seen == 1u);
    REQUIRE(status == expected_final);
    REQUIRE(session.state == state_from_name(vec->expected.state_after));

    last_op = vec->calls[vec->call_count - 1u].op;
    if (strcmp(last_op, "finalize") == 0 || strcmp(last_op, "abort") == 0) {
        REQUIRE(result.status == status);
        REQUIRE(result.adopted == vec->expected.adopted);
        REQUIRE(result.recognizable_future_seen
            == vec->expected.recognizable_future_seen);
        REQUIRE(result.family14_row_count == vec->expected.family14_row_count);
        REQUIRE(result.current_domain_key_count
            == vec->expected.current_domain_key_count);
        REQUIRE(result.ok_row_count == vec->expected.ok_row_count);
        REQUIRE(result.profile_exact_active
            == vec->expected.profile_exact_active);
        REQUIRE(result.profile_mismatch == vec->expected.profile_mismatch);
        REQUIRE(result.future_profile_candidate
            == vec->expected.future_profile_candidate);
        REQUIRE(result.profile_get_present_mask
            == vec->expected.profile_get_present_mask);
        REQUIRE(result.family14_iter_seen_mask
            == vec->expected.family14_iter_seen_mask);
        REQUIRE(result.reopen_required == vec->expected.reopen_required);
    }

    /* Phase / masks / sticky retained on context after finalize/abort. */
    REQUIRE(d3s2_context.phase == vec->expected.phase);
    REQUIRE(d3s2_context.count_complete_mask
        == vec->expected.count_complete_mask);
    REQUIRE(d3s2_context.binding_complete_mask
        == vec->expected.binding_complete_mask);
    REQUIRE(d3s2_context.flags == vec->expected.flags);
    REQUIRE(d3s2_context.focus_mode == vec->mode);
    REQUIRE((d3s2_context.flags & NINLIL_DOMAIN_SCAN_D3S2_FLAG_BASELINE_DONE)
        != 0u);

    if (expect_evaluator_off) {
        REQUIRE(d3s2_context.phase == NINLIL_DOMAIN_SCAN_D3S2_PHASE_BASELINE);
        REQUIRE(d3s2_context.pass_kind == NINLIL_DOMAIN_SCAN_D3S2_PASS_BASELINE);
        REQUIRE(d3s2_context.flags == NINLIL_DOMAIN_SCAN_D3S2_FLAG_BASELINE_DONE);
        REQUIRE(
            (d3s2_context.flags & NINLIL_DOMAIN_SCAN_D3S2_FLAG_COMPLETE_READY)
            == 0u);
        REQUIRE(
            (d3s2_context.flags & NINLIL_DOMAIN_SCAN_D3S2_FLAG_FOCUS_LIVE) == 0u);
        REQUIRE((d3s2_context.flags
                    & NINLIL_DOMAIN_SCAN_D3S2_FLAG_BIND_PHASE_ACTIVE)
            == 0u);
        REQUIRE(d3s2_context.count_complete_mask == 0u);
        REQUIRE(d3s2_context.binding_complete_mask == 0u);
        REQUIRE(session.has_sticky_primary == 0u);
        REQUIRE(vec->expected.has_sticky_primary == 0u);
        REQUIRE(vec->expected.adopted == 0u);
        REQUIRE(expected_final == NINLIL_E_UNSUPPORTED);
        REQUIRE(vec->expected.iter_open_count == 1u);
        REQUIRE(vec->expected.d3_peer_get_count == 0u);
    } else if (expect_complete) {
        REQUIRE(d3s2_context.phase == NINLIL_DOMAIN_SCAN_D3S2_PHASE_COMPLETE);
        REQUIRE(
            (d3s2_context.flags & NINLIL_DOMAIN_SCAN_D3S2_FLAG_COMPLETE_READY)
            != 0u);
        REQUIRE(d3s2_context.binding_complete_mask
            == ninlil_domain_scan_d3s2_required_binding_mask(vec->mode));
        REQUIRE(session.has_sticky_primary == 0u);
        REQUIRE(vec->expected.has_sticky_primary == 0u);
        REQUIRE(vec->expected.adopted == 1u);
    } else {
        REQUIRE(d3s2_context.phase == NINLIL_DOMAIN_SCAN_D3S2_PHASE_FAILED);
        REQUIRE(
            (d3s2_context.flags & NINLIL_DOMAIN_SCAN_D3S2_FLAG_COMPLETE_READY)
            == 0u);
        REQUIRE(session.has_sticky_primary != 0u);
        REQUIRE(vec->expected.has_sticky_primary != 0u);
        REQUIRE(session.sticky_primary
            == status_from_name(vec->expected.sticky_primary));
        REQUIRE(vec->expected.adopted == 0u);
    }

    REQUIRE(spy.close_calls == vec->expected.close_count);
    REQUIRE(spy.mutation_calls == 0u);
    REQUIRE(ninlil_spy_assert_no_mutations(&spy));
    REQUIRE(vec->expected.mutation_calls == 0u);
    REQUIRE(spy.iter_open_calls == vec->expected.iter_open_count);
    /*
     * Same-txn multipass (every d3s2 vector): production records exactly one
     * begin. Two-txn list-then-count models are rejected by generator check
     * self-test (port_trace with a second begin:READ_ONLY); this bridge does
     * not invent a multi-txn harness.
     */
    REQUIRE(spy.begin_calls == 1u);

    /* Full Port-trace equality (independent oracle; not dumped from prod). */
    for (i = 0u; i < spy.trace_count; ++i) {
        const char *name = NULL;
        REQUIRE(mapped_trace < NINLIL_D3S2_MAX_TRACE);
        REQUIRE(map_spy_op_to_oracle_name(spy.trace[i].op, &name));
        mapped[mapped_trace++] = name;
    }
    if (mapped_trace != vec->expected.port_trace_count) {
        (void)fprintf(stderr,
            "%s: port_trace count got %zu want %zu\n", current_id,
            mapped_trace, vec->expected.port_trace_count);
        for (i = 0u; i < mapped_trace && i < 64u; ++i) {
            (void)fprintf(stderr, "  got[%zu]=%s\n", i, mapped[i]);
        }
        for (i = 0u; i < vec->expected.port_trace_count && i < 64u; ++i) {
            (void)fprintf(stderr, "  want[%zu]=%s\n", i,
                vec->expected.port_trace[i]);
        }
        return 1;
    }
    for (i = 0u; i < mapped_trace; ++i) {
        if (strcmp(mapped[i], vec->expected.port_trace[i]) != 0) {
            (void)fprintf(stderr,
                "%s: port_trace[%zu] got=%s want=%s\n", current_id, i,
                mapped[i], vec->expected.port_trace[i]);
            return 1;
        }
    }

    /* Exact get counts from production spy + port-trace derivation.
     * total Port gets == spy.get_calls; peer gets = gets after first
     * iter_open (baseline profile 17 excluded via begin/baseline boundary). */
    observed_get_total = 0u;
    baseline_gets = 0u;
    {
        int after_iter_open = 0;
        for (i = 0u; i < mapped_trace; ++i) {
            if (strcmp(mapped[i], "get") == 0) {
                observed_get_total += 1u;
                if (after_iter_open == 0) {
                    baseline_gets += 1u;
                }
            } else if (strcmp(mapped[i], "iter_open:prefix0") == 0) {
                after_iter_open = 1;
            } else if (strcmp(mapped[i], "begin:READ_ONLY") == 0) {
                after_iter_open = 0;
            }
        }
    }
    REQUIRE(spy.get_calls == (uint32_t)observed_get_total);
    observed_peer_gets = count_peer_gets_from_trace(mapped, mapped_trace);
    REQUIRE(observed_peer_gets + baseline_gets == observed_get_total);
    REQUIRE(baseline_gets == 17u);
    REQUIRE(observed_peer_gets == vec->expected.d3_peer_get_count);
    /* Production spy total minus rigorously derived baseline equals peer. */
    REQUIRE((uint64_t)spy.get_calls - baseline_gets
        == vec->expected.d3_peer_get_count);

    return 0;
}

int main(void)
{
    size_t i;
    size_t smoke_n = 0u;
    size_t mode25_n = 0u;
    size_t mode26_n = 0u;
    size_t mode24_n = 0u;
    size_t mode23_n = 0u;
    size_t mode22_n = 0u;
    size_t mode21_n = 0u;
    size_t p0a_n = 0u;
    size_t p0b_n = 0u;
    size_t p0c_n = 0u;
    size_t p0d_n = 0u;
    size_t p1a_n = 0u;
    size_t p1d_n = 0u;
    size_t p1d2_n = 0u;
    size_t p1b1_n = 0u;
    size_t p1b2_n = 0u;
    size_t p1c1_n = 0u;
    size_t p1c2_n = 0u;

    /* Both pins live in the shared append-only fixture. */
    REQUIRE(NINLIL_D3S1_VECTOR_COUNT == 94u);
    REQUIRE(NINLIL_D3S2_VECTOR_COUNT == 49u);
    REQUIRE(NINLIL_D3S1_WORKSPACE_CEILING_BYTES == 8192u);
    REQUIRE(sizeof(ninlil_domain_scan_workspace_t)
        <= NINLIL_DOMAIN_SCANNER_WORKSPACE_CEILING_BYTES);
    REQUIRE(sizeof(ninlil_domain_scan_d3s2_context_t)
        == NINLIL_DOMAIN_SCAN_D3S2_CONTEXT_SIZE_BYTES);
    REQUIRE(_Alignof(ninlil_domain_scan_d3s2_context_t) == 1);

    for (i = 0u; i < NINLIL_D3S2_VECTOR_COUNT; ++i) {
        REQUIRE(ninlil_d3s2_vectors[i].id != NULL);
        REQUIRE(ninlil_d3s2_vectors[i].kind != NULL);
        REQUIRE(ninlil_d3s2_vectors[i].kind[0] != '\0');
        REQUIRE(ninlil_d3s2_vectors[i].mode >= 21u
            && ninlil_d3s2_vectors[i].mode <= 26u);

        if (i < 6u) {
            /* First six remain Mode21..26 empty-carrier smoke, one mode each. */
            REQUIRE(ninlil_d3s2_vectors[i].mode == (uint8_t)(21u + i));
            smoke_n += 1u;
        } else if (i < 8u) {
            REQUIRE(ninlil_d3s2_vectors[i].mode == 25u);
            mode25_n += 1u;
        } else if (i < 10u) {
            REQUIRE(ninlil_d3s2_vectors[i].mode == 26u);
            mode26_n += 1u;
        } else if (i < 12u) {
            REQUIRE(ninlil_d3s2_vectors[i].mode == 24u);
            mode24_n += 1u;
        } else if (i < 14u) {
            REQUIRE(ninlil_d3s2_vectors[i].mode == 23u);
            mode23_n += 1u;
        } else if (i < 16u) {
            REQUIRE(ninlil_d3s2_vectors[i].mode == 22u);
            mode22_n += 1u;
        } else if (i < 18u) {
            REQUIRE(ninlil_d3s2_vectors[i].mode == 21u);
            mode21_n += 1u;
        } else if (i < 19u) {
            /* P0-A: Mode25 multi-owner SHA interleave + dual carrier. */
            REQUIRE(ninlil_d3s2_vectors[i].mode == 25u);
            REQUIRE(strcmp(ninlil_d3s2_vectors[i].id,
                        "D3S2_M25_TWO_OWNER_SHA_INTERLEAVE_DUAL_CARRIER_OK")
                == 0);
            REQUIRE(strcmp(ninlil_d3s2_vectors[i].kind,
                        "mode25_two_owner_sha_interleave_dual_carrier_ok")
                == 0);
            p0a_n += 1u;
        } else if (i < 20u) {
            /* P0-B: Mode26 mid-FOCUS budget stop + same-iterator resume. */
            REQUIRE(ninlil_d3s2_vectors[i].mode == 26u);
            REQUIRE(strcmp(ninlil_d3s2_vectors[i].id,
                        "D3S2_M26_ES_MGMT_BUDGET_MID_FOCUS_RESUME_OK")
                == 0);
            REQUIRE(strcmp(ninlil_d3s2_vectors[i].kind,
                        "mode26_es_mgmt_budget_mid_focus_resume_ok")
                == 0);
            p0b_n += 1u;
        } else if (i < 21u) {
            /*
             * P0-C: BIND Port IO_ERROR. Production evidence is sticky STORAGE
             * (not CORRUPT), FAILED, incomplete BIND mask, exact fault/trace
             * (via run_vector). Formal JSON note_count is not in the C fixture.
             */
            REQUIRE(ninlil_d3s2_vectors[i].mode == 25u);
            REQUIRE(strcmp(ninlil_d3s2_vectors[i].id,
                        "D3S2_M25_BIND_EXACT_GET_PORT_FAILURE_NOTE0")
                == 0);
            REQUIRE(strcmp(ninlil_d3s2_vectors[i].kind,
                        "mode25_bind_exact_get_port_failure_note0")
                == 0);
            REQUIRE(strcmp(ninlil_d3s2_vectors[i].expected.final_status,
                        "STORAGE")
                == 0);
            REQUIRE(strcmp(ninlil_d3s2_vectors[i].expected.sticky_primary,
                        "STORAGE")
                == 0);
            REQUIRE(ninlil_d3s2_vectors[i].expected.phase
                == NINLIL_DOMAIN_SCAN_D3S2_PHASE_FAILED);
            REQUIRE(ninlil_d3s2_vectors[i].expected.binding_complete_mask
                == 0u);
            REQUIRE(ninlil_d3s2_vectors[i].fault_count == 1u);
            REQUIRE(strcmp(ninlil_d3s2_vectors[i].faults[0].op, "get") == 0);
            REQUIRE(ninlil_d3s2_vectors[i].faults[0].on_call == 23u);
            REQUIRE(strcmp(ninlil_d3s2_vectors[i].faults[0].status, "IO_ERROR")
                == 0);
            p0c_n += 1u;
        } else if (i < 25u) {
            /* P0-D: Mode22 unexpected INDEX / true-primary ABSENT /
             * Mode21 PVD / Mode21 pair subject — STORAGE_CORRUPT note path.
             * Pair subject is not true-primary raw coverage. */
            REQUIRE(ninlil_d3s2_vectors[i].mode == 22u
                || ninlil_d3s2_vectors[i].mode == 21u);
            REQUIRE(strcmp(ninlil_d3s2_vectors[i].expected.final_status,
                        "STORAGE_CORRUPT")
                == 0);
            REQUIRE(strcmp(ninlil_d3s2_vectors[i].expected.sticky_primary,
                        "STORAGE_CORRUPT")
                == 0);
            REQUIRE(ninlil_d3s2_vectors[i].expected.phase
                == NINLIL_DOMAIN_SCAN_D3S2_PHASE_FAILED);
            REQUIRE(ninlil_d3s2_vectors[i].expected.binding_complete_mask
                == 0u);
            REQUIRE(ninlil_d3s2_vectors[i].expected.mutation_calls == 0u);
            REQUIRE(ninlil_d3s2_vectors[i].fault_count == 0u);
            if (i == 21u) {
                REQUIRE(strcmp(ninlil_d3s2_vectors[i].id,
                            "D3S2_M22_ATT_UNEXPECTED_AII_INDEX_PRESENT")
                    == 0);
                REQUIRE(ninlil_d3s2_vectors[i].expected.d3_peer_get_count
                    == 5u);
            } else if (i == 22u) {
                REQUIRE(strcmp(ninlil_d3s2_vectors[i].id,
                            "D3S2_M22_ATT_TRUE_PRIMARY_DELIVERY_ABSENT")
                    == 0);
                REQUIRE(ninlil_d3s2_vectors[i].expected.d3_peer_get_count
                    == 4u);
            } else if (i == 23u) {
                REQUIRE(strcmp(ninlil_d3s2_vectors[i].id,
                            "D3S2_M21_ATT_PRIMARY_PVD_MISMATCH")
                    == 0);
                REQUIRE(ninlil_d3s2_vectors[i].expected.d3_peer_get_count
                    == 4u);
            } else {
                REQUIRE(strcmp(ninlil_d3s2_vectors[i].id,
                            "D3S2_M21_ATT_INDEX_PAIR_SUBJECT_RAW_MISMATCH")
                    == 0);
                REQUIRE(ninlil_d3s2_vectors[i].expected.d3_peer_get_count
                    == 5u);
            }
            p0d_n += 1u;
        } else if (i < 31u) {
            /* P1-A: ordinary CLEANUP ABSENT stream count under/over + empty
             * secondary declared>0 — STORAGE_CORRUPT FOCUS H2 path. */
            REQUIRE(ninlil_d3s2_vectors[i].mode == 21u
                || ninlil_d3s2_vectors[i].mode == 22u
                || ninlil_d3s2_vectors[i].mode == 26u);
            REQUIRE(strcmp(ninlil_d3s2_vectors[i].expected.final_status,
                        "STORAGE_CORRUPT")
                == 0);
            REQUIRE(strcmp(ninlil_d3s2_vectors[i].expected.sticky_primary,
                        "STORAGE_CORRUPT")
                == 0);
            REQUIRE(ninlil_d3s2_vectors[i].expected.phase
                == NINLIL_DOMAIN_SCAN_D3S2_PHASE_FAILED);
            REQUIRE(ninlil_d3s2_vectors[i].expected.binding_complete_mask
                == 0u);
            REQUIRE(ninlil_d3s2_vectors[i].expected.mutation_calls == 0u);
            REQUIRE(ninlil_d3s2_vectors[i].fault_count == 0u);
            if (i == 25u) {
                REQUIRE(strcmp(ninlil_d3s2_vectors[i].id,
                            "D3S2_M21_APP_ATTEMPT_STREAM_OVERCOUNT")
                    == 0);
                REQUIRE(ninlil_d3s2_vectors[i].expected.d3_peer_get_count
                    == 2u);
                REQUIRE(ninlil_d3s2_vectors[i].expected.count_complete_mask
                    == 0u);
            } else if (i == 26u) {
                REQUIRE(strcmp(ninlil_d3s2_vectors[i].id,
                            "D3S2_M21_CANCEL_ATTEMPT_STREAM_OVERCOUNT")
                    == 0);
                REQUIRE(ninlil_d3s2_vectors[i].expected.d3_peer_get_count
                    == 2u);
            } else if (i == 27u) {
                REQUIRE(strcmp(ninlil_d3s2_vectors[i].id,
                            "D3S2_M21_INDEX_STREAM_UNDERCOUNT")
                    == 0);
                REQUIRE(ninlil_d3s2_vectors[i].expected.d3_peer_get_count
                    == 2u);
                REQUIRE(ninlil_d3s2_vectors[i].expected.count_complete_mask
                    == 0x01u);
            } else if (i == 28u) {
                REQUIRE(strcmp(ninlil_d3s2_vectors[i].id,
                            "D3S2_M22_APP_FIRST_EMPTY_SECONDARY_UNDERCOUNT")
                    == 0);
                REQUIRE(ninlil_d3s2_vectors[i].expected.d3_peer_get_count
                    == 2u);
            } else if (i == 29u) {
                REQUIRE(strcmp(ninlil_d3s2_vectors[i].id,
                            "D3S2_M22_CANCEL_FIRST_CANCEL_UNDERCOUNT")
                    == 0);
                REQUIRE(ninlil_d3s2_vectors[i].expected.d3_peer_get_count
                    == 2u);
            } else {
                REQUIRE(i == 30u);
                REQUIRE(strcmp(ninlil_d3s2_vectors[i].id,
                            "D3S2_M26_MGMT_STREAM_OVERCOUNT")
                    == 0);
                REQUIRE(ninlil_d3s2_vectors[i].expected.d3_peer_get_count
                    == 0u);
            }
            p1a_n += 1u;
        } else if (i < 33u) {
            /* P1-D: profile mismatch / future_profile evaluator-off
             * (§18.13.15 case12) — BASELINE + BASELINE_DONE only;
             * UNSUPPORTED/adopted0; not COMPLETE/FAILED. */
            REQUIRE(ninlil_d3s2_vectors[i].mode == 21u);
            REQUIRE(strcmp(ninlil_d3s2_vectors[i].expected.final_status,
                        "UNSUPPORTED")
                == 0);
            REQUIRE(ninlil_d3s2_vectors[i].expected.adopted == 0u);
            REQUIRE(ninlil_d3s2_vectors[i].expected.phase
                == NINLIL_DOMAIN_SCAN_D3S2_PHASE_BASELINE);
            REQUIRE(ninlil_d3s2_vectors[i].expected.flags
                == NINLIL_DOMAIN_SCAN_D3S2_FLAG_BASELINE_DONE);
            REQUIRE((ninlil_d3s2_vectors[i].expected.flags
                        & NINLIL_DOMAIN_SCAN_D3S2_FLAG_COMPLETE_READY)
                == 0u);
            REQUIRE(ninlil_d3s2_vectors[i].expected.count_complete_mask == 0u);
            REQUIRE(ninlil_d3s2_vectors[i].expected.binding_complete_mask
                == 0u);
            REQUIRE(ninlil_d3s2_vectors[i].expected.profile_exact_active
                == 0u);
            REQUIRE(ninlil_d3s2_vectors[i].expected.iter_open_count == 1u);
            REQUIRE(ninlil_d3s2_vectors[i].expected.d3_peer_get_count == 0u);
            REQUIRE(ninlil_d3s2_vectors[i].expected.mutation_calls == 0u);
            REQUIRE(ninlil_d3s2_vectors[i].expected.has_sticky_primary == 0u);
            REQUIRE(ninlil_d3s2_vectors[i].fault_count == 0u);
            if (i == 31u) {
                REQUIRE(strcmp(ninlil_d3s2_vectors[i].id,
                            "D3S2_M21_PROFILE_MISMATCH_EVALUATOR_OFF")
                    == 0);
                REQUIRE(ninlil_d3s2_vectors[i].expected.profile_mismatch
                    == 1u);
                REQUIRE(
                    ninlil_d3s2_vectors[i].expected.future_profile_candidate
                    == 0u);
            } else {
                REQUIRE(i == 32u);
                REQUIRE(strcmp(ninlil_d3s2_vectors[i].id,
                            "D3S2_M21_FUTURE_PROFILE_EVALUATOR_OFF")
                    == 0);
                REQUIRE(ninlil_d3s2_vectors[i].expected.profile_mismatch
                    == 0u);
                REQUIRE(
                    ninlil_d3s2_vectors[i].expected.future_profile_candidate
                    == 1u);
            }
            p1d_n += 1u;
        } else if (i < 34u) {
            /* P1-D2: count-green without BIND false-terminal (§18.13.15 case10).
             * Inventory pin only; run_vector exercises checkpoint + probe +
             * resume COMPLETE. */
            REQUIRE(i == 33u);
            REQUIRE(ninlil_d3s2_vectors[i].mode == 21u);
            REQUIRE(strcmp(ninlil_d3s2_vectors[i].id,
                        "D3S2_M21_COUNT_GREEN_BIND_INCOMPLETE_FALSE_TERMINAL_OK")
                == 0);
            REQUIRE(strcmp(ninlil_d3s2_vectors[i].kind,
                        "mode21_count_green_bind_incomplete_false_terminal_ok")
                == 0);
            REQUIRE(strcmp(ninlil_d3s2_vectors[i].expected.final_status, "OK")
                == 0);
            REQUIRE(ninlil_d3s2_vectors[i].expected.adopted == 1u);
            REQUIRE(ninlil_d3s2_vectors[i].expected.phase
                == NINLIL_DOMAIN_SCAN_D3S2_PHASE_COMPLETE);
            REQUIRE(ninlil_d3s2_vectors[i].expected.count_complete_mask
                == (uint8_t)(NINLIL_DOMAIN_SCAN_D3S2_MASK_ATTEMPT
                    | NINLIL_DOMAIN_SCAN_D3S2_MASK_INDEX));
            REQUIRE(ninlil_d3s2_vectors[i].expected.binding_complete_mask
                == (uint8_t)(NINLIL_DOMAIN_SCAN_D3S2_MASK_ATTEMPT
                    | NINLIL_DOMAIN_SCAN_D3S2_MASK_INDEX));
            REQUIRE(ninlil_d3s2_vectors[i].expected.d3_peer_get_count == 7u);
            REQUIRE(ninlil_d3s2_vectors[i].expected.mutation_calls == 0u);
            REQUIRE(ninlil_d3s2_vectors[i].fault_count == 0u);
            {
                size_t ci;
                size_t probe_n = 0u;
                size_t cp_n = 0u;
                for (ci = 0u; ci < ninlil_d3s2_vectors[i].call_count; ++ci) {
                    if (strcmp(ninlil_d3s2_vectors[i].calls[ci].op,
                            "probe_false_terminal_finalize")
                        == 0) {
                        probe_n += 1u;
                        REQUIRE(strcmp(
                                    ninlil_d3s2_vectors[i]
                                        .calls[ci]
                                        .expected_status,
                                    "INVALID_STATE")
                            == 0);
                    }
                    if (ninlil_d3s2_vectors[i].calls[ci].has_checkpoint
                        != 0u) {
                        cp_n += 1u;
                        REQUIRE(ninlil_d3s2_vectors[i].calls[ci].cp_phase
                            == NINLIL_DOMAIN_SCAN_D3S2_PHASE_BIND_ATTEMPT);
                        REQUIRE(ninlil_d3s2_vectors[i]
                                .calls[ci]
                                .cp_count_complete_mask
                            == (uint8_t)(NINLIL_DOMAIN_SCAN_D3S2_MASK_ATTEMPT
                                | NINLIL_DOMAIN_SCAN_D3S2_MASK_INDEX));
                        REQUIRE(ninlil_d3s2_vectors[i]
                                .calls[ci]
                                .cp_binding_complete_mask
                            == 0u);
                        REQUIRE((ninlil_d3s2_vectors[i].calls[ci].cp_flags
                                    & NINLIL_DOMAIN_SCAN_D3S2_FLAG_COMPLETE_READY)
                            == 0u);
                        REQUIRE((ninlil_d3s2_vectors[i].calls[ci].cp_flags
                                    & NINLIL_DOMAIN_SCAN_D3S2_FLAG_BIND_PHASE_ACTIVE)
                            != 0u);
                    }
                }
                REQUIRE(probe_n == 1u);
                REQUIRE(cp_n == 1u);
            }
            p1d2_n += 1u;
        } else if (i < 36u) {
            /* P1-B1: CLEANUP_PLAN Modes22–23 (§18.13.15 case5 / §18.13.8).
             * Inventory pin only; run_vector exercises checkpoint + real
             * production path (skip COMPLETE / still-ordinary CORRUPT). */
            REQUIRE(i >= 34u && i < 36u);
            REQUIRE(ninlil_d3s2_vectors[i].fault_count == 0u);
            REQUIRE(ninlil_d3s2_vectors[i].expected.mutation_calls == 0u);
            {
                size_t ci;
                size_t cp_n = 0u;
                for (ci = 0u; ci < ninlil_d3s2_vectors[i].call_count; ++ci) {
                    if (ninlil_d3s2_vectors[i].calls[ci].has_checkpoint
                        != 0u) {
                        cp_n += 1u;
                    }
                }
                REQUIRE(cp_n == 1u);
            }
            if (i == 34u) {
                REQUIRE(ninlil_d3s2_vectors[i].mode == 22u);
                REQUIRE(strcmp(ninlil_d3s2_vectors[i].id,
                            "D3S2_M22_CLEANUP_PLAN_PRESENT_ORDINARY_SKIP_OK")
                    == 0);
                REQUIRE(strcmp(ninlil_d3s2_vectors[i].kind,
                            "mode22_cleanup_plan_present_ordinary_skip_ok")
                    == 0);
                REQUIRE(strcmp(ninlil_d3s2_vectors[i].expected.final_status,
                            "OK")
                    == 0);
                REQUIRE(ninlil_d3s2_vectors[i].expected.adopted == 1u);
                REQUIRE(ninlil_d3s2_vectors[i].expected.phase
                    == NINLIL_DOMAIN_SCAN_D3S2_PHASE_COMPLETE);
                REQUIRE(ninlil_d3s2_vectors[i].expected.d3_peer_get_count
                    == 2u);
                REQUIRE(ninlil_d3s2_vectors[i].expected.count_complete_mask
                    == NINLIL_DOMAIN_SCAN_D3S2_MASK_ATTEMPT);
                REQUIRE(ninlil_d3s2_vectors[i].expected.binding_complete_mask
                    == NINLIL_DOMAIN_SCAN_D3S2_MASK_ATTEMPT);
                {
                    size_t ci;
                    for (ci = 0u; ci < ninlil_d3s2_vectors[i].call_count;
                        ++ci) {
                        if (ninlil_d3s2_vectors[i].calls[ci].has_checkpoint
                            != 0u) {
                            REQUIRE(ninlil_d3s2_vectors[i]
                                    .calls[ci]
                                    .cp_cleanup_skip
                                == 1u);
                            REQUIRE(ninlil_d3s2_vectors[i].calls[ci].cp_phase
                                == NINLIL_DOMAIN_SCAN_D3S2_PHASE_FOCUS_ATTEMPT);
                            REQUIRE(ninlil_d3s2_vectors[i]
                                    .calls[ci]
                                    .cp_focus_live
                                == 1u);
                        }
                    }
                }
            } else {
                REQUIRE(i == 35u);
                REQUIRE(ninlil_d3s2_vectors[i].mode == 23u);
                REQUIRE(strcmp(ninlil_d3s2_vectors[i].id,
                            "D3S2_M23_CLEANUP_PLAN_PRESENT_STILL_ORDINARY_CORRUPT")
                    == 0);
                REQUIRE(strcmp(ninlil_d3s2_vectors[i].kind,
                            "mode23_cleanup_plan_present_still_ordinary_corrupt")
                    == 0);
                REQUIRE(strcmp(ninlil_d3s2_vectors[i].expected.final_status,
                            "STORAGE_CORRUPT")
                    == 0);
                REQUIRE(ninlil_d3s2_vectors[i].expected.adopted == 0u);
                REQUIRE(ninlil_d3s2_vectors[i].expected.phase
                    == NINLIL_DOMAIN_SCAN_D3S2_PHASE_FAILED);
                REQUIRE(ninlil_d3s2_vectors[i].expected.has_sticky_primary
                    == 1u);
                REQUIRE(ninlil_d3s2_vectors[i].expected.d3_peer_get_count
                    == 4u);
                {
                    size_t ci;
                    for (ci = 0u; ci < ninlil_d3s2_vectors[i].call_count;
                        ++ci) {
                        if (ninlil_d3s2_vectors[i].calls[ci].has_checkpoint
                            != 0u) {
                            REQUIRE(ninlil_d3s2_vectors[i]
                                    .calls[ci]
                                    .cp_cleanup_skip
                                == 0u);
                            REQUIRE(ninlil_d3s2_vectors[i].calls[ci].cp_phase
                                == NINLIL_DOMAIN_SCAN_D3S2_PHASE_FAILED);
                            REQUIRE(ninlil_d3s2_vectors[i]
                                    .calls[ci]
                                    .cp_focus_live
                                == 1u);
                        }
                    }
                }
            }
            p1b1_n += 1u;
        } else if (i >= 36u && i < 39u) {
            /* P1-B2: CLEANUP_PLAN Modes24–26 still-ordinary
             * (§18.13.15 case5 residual / §18.13.8). Inventory pin only;
             * run_vector exercises checkpoint + real production CORRUPT. */
            REQUIRE(ninlil_d3s2_vectors[i].fault_count == 0u);
            REQUIRE(ninlil_d3s2_vectors[i].expected.mutation_calls == 0u);
            REQUIRE(strcmp(ninlil_d3s2_vectors[i].expected.final_status,
                        "STORAGE_CORRUPT")
                == 0);
            REQUIRE(ninlil_d3s2_vectors[i].expected.adopted == 0u);
            REQUIRE(ninlil_d3s2_vectors[i].expected.phase
                == NINLIL_DOMAIN_SCAN_D3S2_PHASE_FAILED);
            REQUIRE(ninlil_d3s2_vectors[i].expected.has_sticky_primary == 1u);
            REQUIRE(strcmp(ninlil_d3s2_vectors[i].expected.sticky_primary,
                        "STORAGE_CORRUPT")
                == 0);
            {
                size_t ci;
                size_t cp_n = 0u;
                for (ci = 0u; ci < ninlil_d3s2_vectors[i].call_count; ++ci) {
                    if (ninlil_d3s2_vectors[i].calls[ci].has_checkpoint
                        != 0u) {
                        cp_n += 1u;
                        REQUIRE(ninlil_d3s2_vectors[i].calls[ci].cp_cleanup_skip
                            == 0u);
                        REQUIRE(ninlil_d3s2_vectors[i].calls[ci].cp_phase
                            == NINLIL_DOMAIN_SCAN_D3S2_PHASE_FAILED);
                        REQUIRE(ninlil_d3s2_vectors[i].calls[ci].cp_focus_live
                            == 1u);
                    }
                }
                REQUIRE(cp_n == 1u);
            }
            if (i == 36u) {
                REQUIRE(ninlil_d3s2_vectors[i].mode == 24u);
                REQUIRE(strcmp(ninlil_d3s2_vectors[i].id,
                            "D3S2_M24_CLEANUP_PLAN_PRESENT_STILL_ORDINARY_CORRUPT")
                    == 0);
                REQUIRE(strcmp(ninlil_d3s2_vectors[i].kind,
                            "mode24_cleanup_plan_present_still_ordinary_corrupt")
                    == 0);
                REQUIRE(ninlil_d3s2_vectors[i].expected.d3_peer_get_count
                    == 4u);
            } else if (i == 37u) {
                REQUIRE(ninlil_d3s2_vectors[i].mode == 25u);
                REQUIRE(strcmp(ninlil_d3s2_vectors[i].id,
                            "D3S2_M25_CLEANUP_PLAN_PRESENT_STILL_ORDINARY_CORRUPT")
                    == 0);
                REQUIRE(strcmp(ninlil_d3s2_vectors[i].kind,
                            "mode25_cleanup_plan_present_still_ordinary_corrupt")
                    == 0);
                REQUIRE(ninlil_d3s2_vectors[i].expected.d3_peer_get_count
                    == 5u);
            } else {
                REQUIRE(i == 38u);
                REQUIRE(ninlil_d3s2_vectors[i].mode == 26u);
                REQUIRE(strcmp(ninlil_d3s2_vectors[i].id,
                            "D3S2_M26_CLEANUP_PLAN_PRESENT_STILL_ORDINARY_CORRUPT")
                    == 0);
                REQUIRE(strcmp(ninlil_d3s2_vectors[i].kind,
                            "mode26_cleanup_plan_present_still_ordinary_corrupt")
                    == 0);
                REQUIRE(ninlil_d3s2_vectors[i].expected.d3_peer_get_count
                    == 0u);
            }
            p1b2_n += 1u;
        } else if (i < 45u) {
            /* P1-C1: Mode23 illegal/equation/late + CANCEL/multi-owner
             * (§18.13.15 cases3,19 / §18.13.12.1 slot authority). */
            REQUIRE(i >= 39u && i < 45u);
            REQUIRE(ninlil_d3s2_vectors[i].mode == 23u);
            REQUIRE(ninlil_d3s2_vectors[i].fault_count == 0u);
            REQUIRE(ninlil_d3s2_vectors[i].expected.mutation_calls == 0u);
            if (i == 39u) {
                REQUIRE(strcmp(ninlil_d3s2_vectors[i].id,
                            "D3S2_M23_ILLEGAL_SLOT_L_PLUS_1_BIND_CORRUPT")
                    == 0);
                REQUIRE(strcmp(ninlil_d3s2_vectors[i].kind,
                            "mode23_illegal_slot_L_plus_1_bind_corrupt")
                    == 0);
                REQUIRE(strcmp(ninlil_d3s2_vectors[i].expected.final_status,
                            "STORAGE_CORRUPT")
                    == 0);
                REQUIRE(ninlil_d3s2_vectors[i].expected.count_complete_mask
                    == NINLIL_DOMAIN_SCAN_D3S2_MASK_EVIDENCE);
                REQUIRE(ninlil_d3s2_vectors[i].expected.d3_peer_get_count
                    == 13u);
            } else if (i == 40u) {
                REQUIRE(strcmp(ninlil_d3s2_vectors[i].id,
                            "D3S2_M23_EQUATION_FAIL_VALID_NE_M_PLUS_OVERFLOW_CORRUPT")
                    == 0);
                REQUIRE(ninlil_d3s2_vectors[i].expected.d3_peer_get_count
                    == 4u);
            } else if (i == 41u) {
                REQUIRE(strcmp(ninlil_d3s2_vectors[i].id,
                            "D3S2_M23_LATE_COHERENCE_OBSERVED_GT_DECLARED_CORRUPT")
                    == 0);
                REQUIRE(ninlil_d3s2_vectors[i].expected.d3_peer_get_count
                    == 4u);
            } else if (i == 42u) {
                REQUIRE(strcmp(ninlil_d3s2_vectors[i].id,
                            "D3S2_M23_CANCEL_FIRST_SLOT0_BIND_CORRUPT")
                    == 0);
                REQUIRE(strcmp(ninlil_d3s2_vectors[i].kind,
                            "mode23_cancel_first_slot0_bind_corrupt")
                    == 0);
                REQUIRE(ninlil_d3s2_vectors[i].expected.d3_peer_get_count
                    == 1u);
                REQUIRE(ninlil_d3s2_vectors[i].expected.count_complete_mask
                    == NINLIL_DOMAIN_SCAN_D3S2_MASK_EVIDENCE);
            } else if (i == 43u) {
                REQUIRE(strcmp(ninlil_d3s2_vectors[i].id,
                            "D3S2_M23_MULTI_OWNER_CANCEL_LAST_TX_OK")
                    == 0);
                REQUIRE(strcmp(ninlil_d3s2_vectors[i].kind,
                            "mode23_multi_owner_cancel_last_tx_ok")
                    == 0);
                REQUIRE(strcmp(ninlil_d3s2_vectors[i].expected.final_status,
                            "OK")
                    == 0);
                REQUIRE(ninlil_d3s2_vectors[i].expected.adopted == 1u);
                REQUIRE(ninlil_d3s2_vectors[i].expected.phase
                    == NINLIL_DOMAIN_SCAN_D3S2_PHASE_COMPLETE);
                REQUIRE(ninlil_d3s2_vectors[i].expected.d3_peer_get_count
                    == 12u);
                REQUIRE(ninlil_d3s2_vectors[i].expected.binding_complete_mask
                    == NINLIL_DOMAIN_SCAN_D3S2_MASK_EVIDENCE);
            } else {
                REQUIRE(i == 44u);
                REQUIRE(strcmp(ninlil_d3s2_vectors[i].id,
                            "D3S2_M23_MULTI_OWNER_TX_BEFORE_CANCEL_EV_CORRUPT")
                    == 0);
                REQUIRE(strcmp(ninlil_d3s2_vectors[i].kind,
                            "mode23_multi_owner_tx_before_cancel_ev_corrupt")
                    == 0);
                REQUIRE(ninlil_d3s2_vectors[i].expected.d3_peer_get_count
                    == 13u);
                REQUIRE(ninlil_d3s2_vectors[i].expected.count_complete_mask
                    == NINLIL_DOMAIN_SCAN_D3S2_MASK_EVIDENCE);
            }
            if (i != 43u) {
                REQUIRE(strcmp(ninlil_d3s2_vectors[i].expected.final_status,
                            "STORAGE_CORRUPT")
                    == 0);
                REQUIRE(ninlil_d3s2_vectors[i].expected.adopted == 0u);
                REQUIRE(ninlil_d3s2_vectors[i].expected.phase
                    == NINLIL_DOMAIN_SCAN_D3S2_PHASE_FAILED);
                REQUIRE(ninlil_d3s2_vectors[i].expected.has_sticky_primary
                    == 1u);
                REQUIRE(ninlil_d3s2_vectors[i].expected.binding_complete_mask
                    == 0u);
            }
            p1c1_n += 1u;
        } else {
            /* P1-C2: Mode24/25 known-slot declared vs population legality
             * (§18.13.15 case3 residual; D1-valid shape fails only). */
            REQUIRE(i >= 45u && i < 49u);
            REQUIRE(ninlil_d3s2_vectors[i].fault_count == 0u);
            REQUIRE(ninlil_d3s2_vectors[i].expected.mutation_calls == 0u);
            REQUIRE(strcmp(ninlil_d3s2_vectors[i].expected.final_status,
                        "STORAGE_CORRUPT")
                == 0);
            REQUIRE(ninlil_d3s2_vectors[i].expected.adopted == 0u);
            REQUIRE(ninlil_d3s2_vectors[i].expected.phase
                == NINLIL_DOMAIN_SCAN_D3S2_PHASE_FAILED);
            REQUIRE(ninlil_d3s2_vectors[i].expected.has_sticky_primary == 1u);
            REQUIRE(ninlil_d3s2_vectors[i].expected.count_complete_mask == 0u);
            REQUIRE(ninlil_d3s2_vectors[i].expected.binding_complete_mask
                == 0u);
            REQUIRE(ninlil_d3s2_vectors[i].expected.d3_mode_applicable_count
                == 0u);
            if (i == 45u) {
                REQUIRE(ninlil_d3s2_vectors[i].mode == 24u);
                REQUIRE(strcmp(ninlil_d3s2_vectors[i].id,
                            "D3S2_M24_RC_REPLY1_EMPTY_SECONDARY_UNDERCOUNT_CORRUPT")
                    == 0);
                REQUIRE(strcmp(ninlil_d3s2_vectors[i].kind,
                            "mode24_rc_reply1_empty_secondary_undercount_corrupt")
                    == 0);
                REQUIRE(ninlil_d3s2_vectors[i].expected.d3_peer_get_count
                    == 4u);
            } else if (i == 46u) {
                REQUIRE(ninlil_d3s2_vectors[i].mode == 24u);
                REQUIRE(strcmp(ninlil_d3s2_vectors[i].id,
                            "D3S2_M24_RC_REPLY1_EXTRA_DISPOSITION_OVERCOUNT_CORRUPT")
                    == 0);
                REQUIRE(strcmp(ninlil_d3s2_vectors[i].kind,
                            "mode24_rc_reply1_extra_disposition_overcount_corrupt")
                    == 0);
                REQUIRE(ninlil_d3s2_vectors[i].expected.d3_peer_get_count
                    == 4u);
            } else if (i == 47u) {
                REQUIRE(ninlil_d3s2_vectors[i].mode == 25u);
                REQUIRE(strcmp(ninlil_d3s2_vectors[i].id,
                            "D3S2_M25_CUM_TOTAL1_RECENT_MISSING_UNDERCOUNT_CORRUPT")
                    == 0);
                REQUIRE(strcmp(ninlil_d3s2_vectors[i].kind,
                            "mode25_cum_total1_recent_missing_undercount_corrupt")
                    == 0);
                REQUIRE(ninlil_d3s2_vectors[i].expected.d3_peer_get_count
                    == 5u);
            } else {
                REQUIRE(i == 48u);
                REQUIRE(ninlil_d3s2_vectors[i].mode == 25u);
                REQUIRE(strcmp(ninlil_d3s2_vectors[i].id,
                            "D3S2_M25_CUM_TOTAL1_RECENT_EXTRA_SLOT_OVERCOUNT_CORRUPT")
                    == 0);
                REQUIRE(strcmp(ninlil_d3s2_vectors[i].kind,
                            "mode25_cum_total1_recent_extra_slot_overcount_corrupt")
                    == 0);
                REQUIRE(ninlil_d3s2_vectors[i].expected.d3_peer_get_count
                    == 5u);
            }
            p1c2_n += 1u;
        }

        /* Mode21 success: BIND_INDEX no STATE companion (case15 pin). */
        if (strcmp(ninlil_d3s2_vectors[i].id,
                "D3S2_M21_STATE_CUM1_ATT_TX_AII_ANCHOR_OK")
            == 0) {
            REQUIRE(ninlil_d3s2_vectors[i].expected.d3_peer_get_count == 7u);
            REQUIRE(ninlil_d3s2_vectors[i].expected.d3_mode_applicable_count
                == 2u);
        }

        if (run_vector(&ninlil_d3s2_vectors[i]) != 0) {
            (void)fprintf(stderr,
                "d3s2 crossrow bridge failed on %s kind=%s mode=%u\n",
                ninlil_d3s2_vectors[i].id, ninlil_d3s2_vectors[i].kind,
                (unsigned)ninlil_d3s2_vectors[i].mode);
            return 1;
        }
    }
    REQUIRE(smoke_n == 6u);
    REQUIRE(mode25_n == 2u);
    REQUIRE(mode26_n == 2u);
    REQUIRE(mode24_n == 2u);
    REQUIRE(mode23_n == 2u);
    REQUIRE(mode22_n == 2u);
    REQUIRE(mode21_n == 2u);
    REQUIRE(p0a_n == 1u);
    REQUIRE(p0b_n == 1u);
    REQUIRE(p0c_n == 1u);
    REQUIRE(p0d_n == 4u);
    REQUIRE(p1a_n == 6u);
    REQUIRE(p1d_n == 2u);
    REQUIRE(p1d2_n == 1u);
    REQUIRE(p1b1_n == 2u);
    REQUIRE(p1b2_n == 3u);
    REQUIRE(p1c1_n == 6u);
    REQUIRE(p1c2_n == 4u);
    return 0;
}
