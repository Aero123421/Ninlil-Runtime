    MANIFEST_CONST(NINLIL_ABI_VERSION)
    MANIFEST_CONST(NINLIL_APPLY_APPLICATION_DEDUP)
    MANIFEST_CONST(NINLIL_APPLY_ATOMIC_PARTICIPANT_RESERVED)
    MANIFEST_CONST(NINLIL_APPLY_IDEMPOTENT)
    MANIFEST_CONST(NINLIL_APP_RESULT_DISPOSITION)
    MANIFEST_CONST(NINLIL_APP_RESULT_POSITIVE_EVIDENCE)
    MANIFEST_CONST(NINLIL_ASSURANCE_FOUNDATION_M1A_LOCAL)
    MANIFEST_CONST(NINLIL_ASSURANCE_NONE)
    MANIFEST_CONST(NINLIL_AUTHORITY_CONTROLLER_ONLY)
    MANIFEST_CONST(NINLIL_AUTHORITY_ORIGIN_WITH_GRANT)
    MANIFEST_CONST(NINLIL_BEARER_CORRUPT)
    MANIFEST_CONST(NINLIL_BEARER_DENIED)
    MANIFEST_CONST(NINLIL_BEARER_EMPTY)
    MANIFEST_CONST(NINLIL_BEARER_LOST_UNKNOWN)
    MANIFEST_CONST(NINLIL_BEARER_MESSAGE_APPLICATION)
    MANIFEST_CONST(NINLIL_BEARER_MESSAGE_CANCEL_REQUEST)
    MANIFEST_CONST(NINLIL_BEARER_MESSAGE_CANCEL_RESULT)
    MANIFEST_CONST(NINLIL_BEARER_MESSAGE_CUSTODY_ACCEPTED)
    MANIFEST_CONST(NINLIL_BEARER_MESSAGE_DISPOSITION)
    MANIFEST_CONST(NINLIL_BEARER_MESSAGE_RECEIPT)
    MANIFEST_CONST(NINLIL_BEARER_OK)
    MANIFEST_CONST(NINLIL_BEARER_SEND_ACCEPTED)
    MANIFEST_CONST(NINLIL_BEARER_SEND_DURABLE_CUSTODY)
    MANIFEST_CONST(NINLIL_BEARER_UNAVAILABLE)
    MANIFEST_CONST(NINLIL_BEARER_WOULD_BLOCK)
    MANIFEST_CONST(NINLIL_CALLBACK_COMPLETE)
    MANIFEST_CONST(NINLIL_CALLBACK_DEFER)
    MANIFEST_CONST(NINLIL_CALLBACK_FATAL)
    MANIFEST_CONST(NINLIL_CANCEL_ALREADY_TERMINAL)
    MANIFEST_CONST(NINLIL_CANCEL_FENCED_BEFORE_DISPATCH)
    MANIFEST_CONST(NINLIL_CANCEL_PENDING_REMOTE_FENCE)
    MANIFEST_CONST(NINLIL_CANCEL_TOO_LATE_EFFECT_POSSIBLE)
    MANIFEST_CONST(NINLIL_CLOCK_TRUSTED)
    MANIFEST_CONST(NINLIL_CLOCK_UNCERTAIN)
    MANIFEST_CONST(NINLIL_CUSTODY_RELEASE_ON_TRANSPORT_RESERVED)
    MANIFEST_CONST(NINLIL_CUSTODY_UNTIL_REQUIRED_EVIDENCE)
    MANIFEST_CONST(NINLIL_DEADLINE_INDETERMINATE)
    MANIFEST_CONST(NINLIL_DEADLINE_MET)
    MANIFEST_CONST(NINLIL_DEADLINE_MISSED)
    MANIFEST_CONST(NINLIL_DEADLINE_NOT_APPLICABLE)
    MANIFEST_CONST(NINLIL_DEADLINE_PENDING)
    MANIFEST_CONST(NINLIL_DIGEST_SHA256)
    MANIFEST_CONST(NINLIL_DIRECTION_BIDIRECTIONAL_RESERVED)
    MANIFEST_CONST(NINLIL_DIRECTION_DOWNLINK)
    MANIFEST_CONST(NINLIL_DIRECTION_UPLINK)
    MANIFEST_CONST(NINLIL_DISCARD_DEVICE_DECOMMISSIONED)
    MANIFEST_CONST(NINLIL_DISCARD_INVALID_EVENT)
    MANIFEST_CONST(NINLIL_DISCARD_OPERATOR_OVERRIDE)
    MANIFEST_CONST(NINLIL_DISCARD_TEST_CLEANUP)
    MANIFEST_CONST(NINLIL_DISPOSITION_APPLICATION_BUSY)
    MANIFEST_CONST(NINLIL_DISPOSITION_APPLY_FAILED)
    MANIFEST_CONST(NINLIL_DISPOSITION_CAPACITY_EXHAUSTED)
    MANIFEST_CONST(NINLIL_DISPOSITION_INVALID_PAYLOAD)
    MANIFEST_CONST(NINLIL_DISPOSITION_NONE)
    MANIFEST_CONST(NINLIL_DISPOSITION_OUTCOME_UNKNOWN)
    MANIFEST_CONST(NINLIL_DISPOSITION_RETRY_LATER)
    MANIFEST_CONST(NINLIL_DISPOSITION_STALE_NOT_APPLIED)
    MANIFEST_CONST(NINLIL_DISPOSITION_UNAUTHORIZED_SERVICE)
    MANIFEST_CONST(NINLIL_DISPOSITION_UNSUPPORTED_SCHEMA)
    MANIFEST_CONST(NINLIL_DISPOSITION_VERIFY_FAILED)
    MANIFEST_CONST(NINLIL_DURABILITY_CHECKPOINTED)
    MANIFEST_CONST(NINLIL_DURABILITY_FULL)
    MANIFEST_CONST(NINLIL_DURABILITY_VOLATILE)
    MANIFEST_CONST(NINLIL_EFFECT_CERTAINTY_NONE)
    MANIFEST_CONST(NINLIL_EFFECT_CERTAINTY_NO_EFFECT_PROVEN)
    MANIFEST_CONST(NINLIL_EFFECT_CERTAINTY_POSSIBLE)
    MANIFEST_CONST(NINLIL_ENV_FIELD_RESERVED)
    MANIFEST_CONST(NINLIL_ENV_LAB_RESERVED)
    MANIFEST_CONST(NINLIL_ENV_PRODUCTION_RESERVED)
    MANIFEST_CONST(NINLIL_ENV_TEST)
    MANIFEST_CONST(NINLIL_EVENT_DISCARD_ALREADY_DISCARDED)
    MANIFEST_CONST(NINLIL_EVENT_DISCARD_ALREADY_RELEASED)
    MANIFEST_CONST(NINLIL_EVENT_DISCARD_CONFLICT)
    MANIFEST_CONST(NINLIL_EVENT_DISCARD_DISCARDED)
    MANIFEST_CONST(NINLIL_EVENT_DISCARD_INVALID)
    MANIFEST_CONST(NINLIL_EVENT_DISCARD_NOT_EVENT_FACT)
    MANIFEST_CONST(NINLIL_EVENT_DISCARD_STALE_SPOOL_REVISION)
    MANIFEST_CONST(NINLIL_EVENT_PARK_CAUSE_APPLICATION_REMEDIATION)
    MANIFEST_CONST(NINLIL_EVENT_PARK_CAUSE_BEARER_UNAVAILABLE)
    MANIFEST_CONST(NINLIL_EVENT_PARK_CAUSE_CAPACITY_UNAVAILABLE)
    MANIFEST_CONST(NINLIL_EVENT_PARK_CAUSE_COUNTER_EXHAUSTED)
    MANIFEST_CONST(NINLIL_EVENT_PARK_CAUSE_CYCLE_EXHAUSTED_TRANSIENT)
    MANIFEST_CONST(NINLIL_EVENT_PARK_CAUSE_NONE)
    MANIFEST_CONST(NINLIL_EVENT_RESUME_ALREADY_DISCARDED)
    MANIFEST_CONST(NINLIL_EVENT_RESUME_ALREADY_RELEASED)
    MANIFEST_CONST(NINLIL_EVENT_RESUME_ALREADY_RESUMED)
    MANIFEST_CONST(NINLIL_EVENT_RESUME_CONFLICT)
    MANIFEST_CONST(NINLIL_EVENT_RESUME_INVALID)
    MANIFEST_CONST(NINLIL_EVENT_RESUME_LIMIT_EXHAUSTED)
    MANIFEST_CONST(NINLIL_EVENT_RESUME_NOT_EVENT_FACT)
    MANIFEST_CONST(NINLIL_EVENT_RESUME_NOT_PARKED)
    MANIFEST_CONST(NINLIL_EVENT_RESUME_NOT_RESUMABLE)
    MANIFEST_CONST(NINLIL_EVENT_RESUME_RESUMED)
    MANIFEST_CONST(NINLIL_EVENT_RESUME_STALE_SPOOL_REVISION)
    MANIFEST_CONST(NINLIL_EVIDENCE_APPLIED)
    MANIFEST_CONST(NINLIL_EVIDENCE_DURABLY_RECORDED)
    MANIFEST_CONST(NINLIL_EVIDENCE_NONE)
    MANIFEST_CONST(NINLIL_EVIDENCE_RECEIVED)
    MANIFEST_CONST(NINLIL_EVIDENCE_VERIFIED)
    MANIFEST_CONST(NINLIL_E_ABI_MISMATCH)
    MANIFEST_CONST(NINLIL_E_BUFFER_TOO_SMALL)
    MANIFEST_CONST(NINLIL_E_CALLBACK)
    MANIFEST_CONST(NINLIL_E_CAPACITY_EXHAUSTED)
    MANIFEST_CONST(NINLIL_E_CLOCK_UNCERTAIN)
    MANIFEST_CONST(NINLIL_E_CONFLICT)
    MANIFEST_CONST(NINLIL_E_DEGRADED)
    MANIFEST_CONST(NINLIL_E_ENTROPY)
    MANIFEST_CONST(NINLIL_E_INTERNAL)
    MANIFEST_CONST(NINLIL_E_INVALID_ARGUMENT)
    MANIFEST_CONST(NINLIL_E_INVALID_STATE)
    MANIFEST_CONST(NINLIL_E_NOT_FOUND)
    MANIFEST_CONST(NINLIL_E_REENTRANT)
    MANIFEST_CONST(NINLIL_E_STORAGE)
    MANIFEST_CONST(NINLIL_E_STORAGE_COMMIT_UNKNOWN)
    MANIFEST_CONST(NINLIL_E_STORAGE_CORRUPT)
    MANIFEST_CONST(NINLIL_E_UNSUPPORTED)
    MANIFEST_CONST(NINLIL_E_WOULD_BLOCK)
    MANIFEST_CONST(NINLIL_E_WRONG_THREAD)
    MANIFEST_CONST(NINLIL_FAMILY_CONFIG_RESERVED)
    MANIFEST_CONST(NINLIL_FAMILY_DESIRED_STATE)
    MANIFEST_CONST(NINLIL_FAMILY_EVENT_FACT)
    MANIFEST_CONST(NINLIL_FAMILY_LATEST_STATE_RESERVED)
    MANIFEST_CONST(NINLIL_FAMILY_MASK_DESIRED_STATE)
    MANIFEST_CONST(NINLIL_FAMILY_MASK_EVENT_FACT)
    MANIFEST_CONST(NINLIL_FAMILY_MEASUREMENT_RESERVED)
    MANIFEST_CONST(NINLIL_FAMILY_NETWORK_CONTROL_RESERVED)
    MANIFEST_CONST(NINLIL_FAMILY_TRANSFER_RESERVED)
    MANIFEST_CONST(NINLIL_HEALTH_DEGRADED)
    MANIFEST_CONST(NINLIL_HEALTH_FATAL)
    MANIFEST_CONST(NINLIL_HEALTH_OK)
    MANIFEST_CONST(NINLIL_ID_BYTES)
    MANIFEST_CONST(NINLIL_LOCAL_IDENTITY_HAS_DEVICE)
    MANIFEST_CONST(NINLIL_LOCAL_IDENTITY_HAS_INSTALLATION)
    MANIFEST_CONST(NINLIL_LOCAL_IDENTITY_HAS_SITE)
    MANIFEST_CONST(NINLIL_M1A_ATTEMPTS_PER_RETRY_CYCLE)
    MANIFEST_CONST(NINLIL_M1A_EVENT_DISCARD_OPERATION_SLOT_BYTES)
    MANIFEST_CONST(NINLIL_M1A_EVENT_MANAGEMENT_RESERVATION_BYTES)
    MANIFEST_CONST(NINLIL_M1A_EVENT_RESUME_OPERATION_SLOT_BYTES)
    MANIFEST_CONST(NINLIL_M1A_EVENT_RETRY_SUMMARY_SLOTS)
    MANIFEST_CONST(NINLIL_M1A_MAX_APPLICATION_COMPLETION_TIMEOUT_MS)
    MANIFEST_CONST(NINLIL_M1A_MAX_ATTEMPT_RECEIPT_TIMEOUT_MS)
    MANIFEST_CONST(NINLIL_M1A_MAX_EVENT_RESUME_OPERATIONS)
    MANIFEST_CONST(NINLIL_M1A_MAX_RETENTION_MS)
    MANIFEST_CONST(NINLIL_M1A_MAX_RETRY_BACKOFF_MS)
    MANIFEST_CONST(NINLIL_M1A_MAX_RETRY_DELAY_MS)
    MANIFEST_CONST(NINLIL_M1A_MAX_STORAGE_VALUE_BYTES)
    MANIFEST_CONST(NINLIL_MAX_AUDIT_METADATA_BYTES)
    MANIFEST_CONST(NINLIL_MAX_EVIDENCE_BYTES)
    MANIFEST_CONST(NINLIL_MAX_IDEMPOTENCY_BYTES)
    MANIFEST_CONST(NINLIL_MAX_TEXT_ID_BYTES)
    MANIFEST_CONST(NINLIL_NO_DEADLINE)
    MANIFEST_CONST(NINLIL_OK)
    MANIFEST_CONST(NINLIL_ORIGIN_AUTH_OK)
    MANIFEST_CONST(NINLIL_ORIGIN_AUTH_PERMANENT_FAILURE)
    MANIFEST_CONST(NINLIL_ORIGIN_AUTH_TEMPORARY_FAILURE)
    MANIFEST_CONST(NINLIL_OUTCOME_CANCELLED_BEFORE_EFFECT)
    MANIFEST_CONST(NINLIL_OUTCOME_EXPIRED)
    MANIFEST_CONST(NINLIL_OUTCOME_FAILED_DEFINITIVE)
    MANIFEST_CONST(NINLIL_OUTCOME_NONE)
    MANIFEST_CONST(NINLIL_OUTCOME_SATISFIED)
    MANIFEST_CONST(NINLIL_OUTCOME_SUPERSEDED_RESERVED)
    MANIFEST_CONST(NINLIL_OUTCOME_UNKNOWN)
    MANIFEST_CONST(NINLIL_PORT_OK)
    MANIFEST_CONST(NINLIL_PORT_PERMANENT_FAILURE)
    MANIFEST_CONST(NINLIL_PORT_TEMPORARY_FAILURE)
    MANIFEST_CONST(NINLIL_REASON_APPLICATION_COMPLETION_TIMEOUT)
    MANIFEST_CONST(NINLIL_REASON_APPLICATION_FAILED)
    MANIFEST_CONST(NINLIL_REASON_ATTEMPT_RECEIPT_TIMEOUT_INVALID)
    MANIFEST_CONST(NINLIL_REASON_BEARER_UNAVAILABLE)
    MANIFEST_CONST(NINLIL_REASON_CALLBACK_CONTRACT)
    MANIFEST_CONST(NINLIL_REASON_CANCEL_AFTER_EFFECT_POSSIBLE)
    MANIFEST_CONST(NINLIL_REASON_CANCEL_FENCED_BEFORE_DISPATCH)
    MANIFEST_CONST(NINLIL_REASON_CANCEL_PENDING_REMOTE_FENCE)
    MANIFEST_CONST(NINLIL_REASON_CAPACITY_EXHAUSTED)
    MANIFEST_CONST(NINLIL_REASON_CAPACITY_UNAVAILABLE)
    MANIFEST_CONST(NINLIL_REASON_CLOCK_UNCERTAIN)
    MANIFEST_CONST(NINLIL_REASON_COUNTER_EXHAUSTED)
    MANIFEST_CONST(NINLIL_REASON_CYCLE_EXHAUSTED_TRANSIENT)
    MANIFEST_CONST(NINLIL_REASON_DEADLINE_ELAPSED_BEFORE_DISPATCH)
    MANIFEST_CONST(NINLIL_REASON_DEADLINE_INVALID)
    MANIFEST_CONST(NINLIL_REASON_DISCARD_CONFLICT)
    MANIFEST_CONST(NINLIL_REASON_EFFECT_POSSIBLE_EVIDENCE_MISSING)
    MANIFEST_CONST(NINLIL_REASON_EFFECT_POSSIBLE_EVIDENCE_PENDING)
    MANIFEST_CONST(NINLIL_REASON_EVENTFACT_DEADLINE_UNSUPPORTED)
    MANIFEST_CONST(NINLIL_REASON_EVENT_FACT_IMMUTABLE)
    MANIFEST_CONST(NINLIL_REASON_EVENT_RECEIPT_TIMEOUT)
    MANIFEST_CONST(NINLIL_REASON_EVENT_RETRY_CYCLE_PARKED)
    MANIFEST_CONST(NINLIL_REASON_EVIDENCE_UNSUPPORTED)
    MANIFEST_CONST(NINLIL_REASON_GRANT_EXPIRED)
    MANIFEST_CONST(NINLIL_REASON_GRANT_INVALID)
    MANIFEST_CONST(NINLIL_REASON_GRANT_LIMIT_EXCEEDED)
    MANIFEST_CONST(NINLIL_REASON_GRANT_PROVIDER_UNAVAILABLE)
    MANIFEST_CONST(NINLIL_REASON_IDEMPOTENCY_CONFLICT)
    MANIFEST_CONST(NINLIL_REASON_INVALID_CONTENT_DIGEST)
    MANIFEST_CONST(NINLIL_REASON_INVALID_PAYLOAD_LENGTH)
    MANIFEST_CONST(NINLIL_REASON_INVALID_SCHEMA)
    MANIFEST_CONST(NINLIL_REASON_M1B_ALL_TARGETS_NOT_MET_PARTIAL_EFFECT)
    MANIFEST_CONST(NINLIL_REASON_M1B_SUPERSEDED_BY_NEW_GENERATION)
    MANIFEST_CONST(NINLIL_REASON_MODIFICATION_REQUIRED)
    MANIFEST_CONST(NINLIL_REASON_NONE)
    MANIFEST_CONST(NINLIL_REASON_OPERATOR_DISCARDED_WITHOUT_REQUIRED_RECEIPT)
    MANIFEST_CONST(NINLIL_REASON_OUTCOME_UNKNOWN)
    MANIFEST_CONST(NINLIL_REASON_RATE_EXHAUSTED)
    MANIFEST_CONST(NINLIL_REASON_RECEIVER_UNAVAILABLE)
    MANIFEST_CONST(NINLIL_REASON_RECONCILE_RETRY_LATER)
    MANIFEST_CONST(NINLIL_REASON_REQUIRED_EVIDENCE_LATE)
    MANIFEST_CONST(NINLIL_REASON_REQUIRED_EVIDENCE_MET)
    MANIFEST_CONST(NINLIL_REASON_RESUME_CONFLICT)
    MANIFEST_CONST(NINLIL_REASON_RETRY_BUDGET_EXHAUSTED_NO_EFFECT)
    MANIFEST_CONST(NINLIL_REASON_STALE_AVAILABILITY_EPOCH)
    MANIFEST_CONST(NINLIL_REASON_STALE_SPOOL_REVISION)
    MANIFEST_CONST(NINLIL_REASON_STORAGE_COMMIT_UNKNOWN)
    MANIFEST_CONST(NINLIL_REASON_STORAGE_IO)
    MANIFEST_CONST(NINLIL_REASON_TARGET_COUNT_UNSUPPORTED)
    MANIFEST_CONST(NINLIL_REASON_TARGET_UNAUTHORIZED)
    MANIFEST_CONST(NINLIL_REASON_TRANSPORT_RETRY)
    MANIFEST_CONST(NINLIL_REASON_UNSUPPORTED_DIRECTION)
    MANIFEST_CONST(NINLIL_REASON_UNSUPPORTED_FAMILY)
    MANIFEST_CONST(NINLIL_REASON_UNSUPPORTED_SELECTOR)
    MANIFEST_CONST(NINLIL_RECONCILE_KNOWN_RESULT)
    MANIFEST_CONST(NINLIL_RECONCILE_OUTCOME_UNKNOWN)
    MANIFEST_CONST(NINLIL_RECONCILE_REDELIVER)
    MANIFEST_CONST(NINLIL_RECONCILE_RETRY_LATER)
    MANIFEST_CONST(NINLIL_RESOURCE_DEFERRED_TOKEN)
    MANIFEST_CONST(NINLIL_RESOURCE_DELIVERY)
    MANIFEST_CONST(NINLIL_RESOURCE_EVENT_SPOOL_BYTES)
    MANIFEST_CONST(NINLIL_RESOURCE_EVENT_SPOOL_COUNT)
    MANIFEST_CONST(NINLIL_RESOURCE_EVIDENCE)
    MANIFEST_CONST(NINLIL_RESOURCE_INGRESS)
    MANIFEST_CONST(NINLIL_RESOURCE_OUTBOX_BYTES)
    MANIFEST_CONST(NINLIL_RESOURCE_RESULT_CACHE)
    MANIFEST_CONST(NINLIL_RESOURCE_SERVICE)
    MANIFEST_CONST(NINLIL_RESOURCE_TARGET)
    MANIFEST_CONST(NINLIL_RESOURCE_TRANSACTION)
    MANIFEST_CONST(NINLIL_RESUME_APPLICATION_REMEDIATED)
    MANIFEST_CONST(NINLIL_RESUME_CAPACITY_REMEDIATED)
    MANIFEST_CONST(NINLIL_RESUME_CONNECTIVITY_REMEDIATED)
    MANIFEST_CONST(NINLIL_RESUME_OPERATOR_OVERRIDE)
    MANIFEST_CONST(NINLIL_RESUME_TEST)
    MANIFEST_CONST(NINLIL_RETRY_MODIFIED)
    MANIFEST_CONST(NINLIL_RETRY_NEVER)
    MANIFEST_CONST(NINLIL_RETRY_OPERATOR_ACTION)
    MANIFEST_CONST(NINLIL_RETRY_SAME_AFTER)
    MANIFEST_CONST(NINLIL_ROLE_CELL_AGENT_RESERVED)
    MANIFEST_CONST(NINLIL_ROLE_CONTROLLER)
    MANIFEST_CONST(NINLIL_ROLE_ENDPOINT)
    MANIFEST_CONST(NINLIL_SHA256_BYTES)
    MANIFEST_CONST(NINLIL_STORAGE_BUFFER_TOO_SMALL)
    MANIFEST_CONST(NINLIL_STORAGE_BUSY)
    MANIFEST_CONST(NINLIL_STORAGE_COMMIT_UNKNOWN)
    MANIFEST_CONST(NINLIL_STORAGE_CORRUPT)
    MANIFEST_CONST(NINLIL_STORAGE_IO_ERROR)
    MANIFEST_CONST(NINLIL_STORAGE_NOT_FOUND)
    MANIFEST_CONST(NINLIL_STORAGE_NO_SPACE)
    MANIFEST_CONST(NINLIL_STORAGE_OK)
    MANIFEST_CONST(NINLIL_STORAGE_READ_ONLY)
    MANIFEST_CONST(NINLIL_STORAGE_READ_WRITE)
    MANIFEST_CONST(NINLIL_STORAGE_SCHEMA_M1A)
    MANIFEST_CONST(NINLIL_STORAGE_UNSUPPORTED_SCHEMA)
    MANIFEST_CONST(NINLIL_SUBMISSION_ADMITTED_READY)
    MANIFEST_CONST(NINLIL_SUBMISSION_ADMITTED_SCHEDULED_RESERVED)
    MANIFEST_CONST(NINLIL_SUBMISSION_ALREADY_ADMITTED)
    MANIFEST_CONST(NINLIL_SUBMISSION_COUNTER_OFFERED_RESERVED)
    MANIFEST_CONST(NINLIL_SUBMISSION_IDEMPOTENCY_CONFLICT)
    MANIFEST_CONST(NINLIL_SUBMISSION_INVALID)
    MANIFEST_CONST(NINLIL_SUBMISSION_REJECTED)
    MANIFEST_CONST(NINLIL_TARGET_HAS_DEVICE)
    MANIFEST_CONST(NINLIL_TARGET_HAS_INSTALLATION)
    MANIFEST_CONST(NINLIL_TARGET_HAS_SITE)
    MANIFEST_CONST(NINLIL_TXN_AWAITING_EVIDENCE)
    MANIFEST_CONST(NINLIL_TXN_DISPATCHING)
    MANIFEST_CONST(NINLIL_TXN_PARKED_RETRY)
    MANIFEST_CONST(NINLIL_TXN_READY)
    MANIFEST_CONST(NINLIL_TXN_TERMINAL)
    MANIFEST_CONST(NINLIL_TXN_WAITING_WINDOW)
    MANIFEST_CONST(NINLIL_TX_GATE_DENIED)
    MANIFEST_CONST(NINLIL_TX_GATE_OK)
    MANIFEST_CONST(NINLIL_TX_GATE_TEMPORARY)
