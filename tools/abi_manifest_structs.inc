    MANIFEST_STRUCT_BEGIN(ninlil_id128_t)
    MANIFEST_FIELD(ninlil_id128_t, bytes)
    MANIFEST_STRUCT_END(ninlil_id128_t)
    MANIFEST_STRUCT_BEGIN(ninlil_digest256_t)
    MANIFEST_FIELD(ninlil_digest256_t, algorithm)
    MANIFEST_FIELD(ninlil_digest256_t, reserved_zero)
    MANIFEST_FIELD(ninlil_digest256_t, bytes)
    MANIFEST_STRUCT_END(ninlil_digest256_t)
    MANIFEST_STRUCT_BEGIN(ninlil_bytes_view_t)
    MANIFEST_FIELD(ninlil_bytes_view_t, data)
    MANIFEST_FIELD(ninlil_bytes_view_t, length)
    MANIFEST_STRUCT_END(ninlil_bytes_view_t)
    MANIFEST_STRUCT_BEGIN(ninlil_mut_bytes_t)
    MANIFEST_FIELD(ninlil_mut_bytes_t, data)
    MANIFEST_FIELD(ninlil_mut_bytes_t, capacity)
    MANIFEST_FIELD(ninlil_mut_bytes_t, length)
    MANIFEST_STRUCT_END(ninlil_mut_bytes_t)
    MANIFEST_STRUCT_BEGIN(ninlil_text_id_t)
    MANIFEST_FIELD(ninlil_text_id_t, length)
    MANIFEST_FIELD(ninlil_text_id_t, bytes)
    MANIFEST_STRUCT_END(ninlil_text_id_t)
    MANIFEST_STRUCT_BEGIN(ninlil_local_identity_t)
    MANIFEST_FIELD(ninlil_local_identity_t, abi_version)
    MANIFEST_FIELD(ninlil_local_identity_t, struct_size)
    MANIFEST_FIELD(ninlil_local_identity_t, device_id)
    MANIFEST_FIELD(ninlil_local_identity_t, installation_id)
    MANIFEST_FIELD(ninlil_local_identity_t, site_domain_id)
    MANIFEST_FIELD(ninlil_local_identity_t, binding_epoch)
    MANIFEST_FIELD(ninlil_local_identity_t, membership_epoch)
    MANIFEST_FIELD(ninlil_local_identity_t, flags)
    MANIFEST_FIELD(ninlil_local_identity_t, reserved_zero)
    MANIFEST_STRUCT_END(ninlil_local_identity_t)
    MANIFEST_STRUCT_BEGIN(ninlil_delivery_token_t)
    MANIFEST_FIELD(ninlil_delivery_token_t, abi_version)
    MANIFEST_FIELD(ninlil_delivery_token_t, struct_size)
    MANIFEST_FIELD(ninlil_delivery_token_t, context_id)
    MANIFEST_FIELD(ninlil_delivery_token_t, generation)
    MANIFEST_FIELD(ninlil_delivery_token_t, clock_epoch_id)
    MANIFEST_FIELD(ninlil_delivery_token_t, expires_at_ms)
    MANIFEST_STRUCT_END(ninlil_delivery_token_t)
    MANIFEST_STRUCT_BEGIN(ninlil_allocator_ops_t)
    MANIFEST_FIELD(ninlil_allocator_ops_t, abi_version)
    MANIFEST_FIELD(ninlil_allocator_ops_t, struct_size)
    MANIFEST_FIELD(ninlil_allocator_ops_t, user)
    MANIFEST_FIELD(ninlil_allocator_ops_t, allocate)
    MANIFEST_FIELD(ninlil_allocator_ops_t, deallocate)
    MANIFEST_STRUCT_END(ninlil_allocator_ops_t)
    MANIFEST_STRUCT_BEGIN(ninlil_execution_ops_t)
    MANIFEST_FIELD(ninlil_execution_ops_t, abi_version)
    MANIFEST_FIELD(ninlil_execution_ops_t, struct_size)
    MANIFEST_FIELD(ninlil_execution_ops_t, user)
    MANIFEST_FIELD(ninlil_execution_ops_t, current_context_id)
    MANIFEST_STRUCT_END(ninlil_execution_ops_t)
    MANIFEST_STRUCT_BEGIN(ninlil_time_sample_t)
    MANIFEST_FIELD(ninlil_time_sample_t, abi_version)
    MANIFEST_FIELD(ninlil_time_sample_t, struct_size)
    MANIFEST_FIELD(ninlil_time_sample_t, clock_epoch_id)
    MANIFEST_FIELD(ninlil_time_sample_t, now_ms)
    MANIFEST_FIELD(ninlil_time_sample_t, trust)
    MANIFEST_FIELD(ninlil_time_sample_t, reserved_zero)
    MANIFEST_STRUCT_END(ninlil_time_sample_t)
    MANIFEST_STRUCT_BEGIN(ninlil_clock_ops_t)
    MANIFEST_FIELD(ninlil_clock_ops_t, abi_version)
    MANIFEST_FIELD(ninlil_clock_ops_t, struct_size)
    MANIFEST_FIELD(ninlil_clock_ops_t, user)
    MANIFEST_FIELD(ninlil_clock_ops_t, now)
    MANIFEST_STRUCT_END(ninlil_clock_ops_t)
    MANIFEST_STRUCT_BEGIN(ninlil_entropy_ops_t)
    MANIFEST_FIELD(ninlil_entropy_ops_t, abi_version)
    MANIFEST_FIELD(ninlil_entropy_ops_t, struct_size)
    MANIFEST_FIELD(ninlil_entropy_ops_t, user)
    MANIFEST_FIELD(ninlil_entropy_ops_t, fill)
    MANIFEST_STRUCT_END(ninlil_entropy_ops_t)
    MANIFEST_STRUCT_BEGIN(ninlil_storage_capacity_t)
    MANIFEST_FIELD(ninlil_storage_capacity_t, abi_version)
    MANIFEST_FIELD(ninlil_storage_capacity_t, struct_size)
    MANIFEST_FIELD(ninlil_storage_capacity_t, max_entries)
    MANIFEST_FIELD(ninlil_storage_capacity_t, used_entries)
    MANIFEST_FIELD(ninlil_storage_capacity_t, max_bytes)
    MANIFEST_FIELD(ninlil_storage_capacity_t, used_bytes)
    MANIFEST_STRUCT_END(ninlil_storage_capacity_t)
    MANIFEST_STRUCT_BEGIN(ninlil_storage_ops_t)
    MANIFEST_FIELD(ninlil_storage_ops_t, abi_version)
    MANIFEST_FIELD(ninlil_storage_ops_t, struct_size)
    MANIFEST_FIELD(ninlil_storage_ops_t, user)
    MANIFEST_FIELD(ninlil_storage_ops_t, open)
    MANIFEST_FIELD(ninlil_storage_ops_t, close)
    MANIFEST_FIELD(ninlil_storage_ops_t, begin)
    MANIFEST_FIELD(ninlil_storage_ops_t, get)
    MANIFEST_FIELD(ninlil_storage_ops_t, put)
    MANIFEST_FIELD(ninlil_storage_ops_t, erase)
    MANIFEST_FIELD(ninlil_storage_ops_t, iter_open)
    MANIFEST_FIELD(ninlil_storage_ops_t, iter_next)
    MANIFEST_FIELD(ninlil_storage_ops_t, iter_close)
    MANIFEST_FIELD(ninlil_storage_ops_t, capacity)
    MANIFEST_FIELD(ninlil_storage_ops_t, commit)
    MANIFEST_FIELD(ninlil_storage_ops_t, rollback)
    MANIFEST_STRUCT_END(ninlil_storage_ops_t)
    MANIFEST_STRUCT_BEGIN(ninlil_party_t)
    MANIFEST_FIELD(ninlil_party_t, abi_version)
    MANIFEST_FIELD(ninlil_party_t, struct_size)
    MANIFEST_FIELD(ninlil_party_t, runtime_id)
    MANIFEST_FIELD(ninlil_party_t, application_instance_id)
    MANIFEST_FIELD(ninlil_party_t, local_identity)
    MANIFEST_STRUCT_END(ninlil_party_t)
    MANIFEST_STRUCT_BEGIN(ninlil_concrete_target_t)
    MANIFEST_FIELD(ninlil_concrete_target_t, abi_version)
    MANIFEST_FIELD(ninlil_concrete_target_t, struct_size)
    MANIFEST_FIELD(ninlil_concrete_target_t, target_runtime_id)
    MANIFEST_FIELD(ninlil_concrete_target_t, target_application_instance_id)
    MANIFEST_FIELD(ninlil_concrete_target_t, device_id)
    MANIFEST_FIELD(ninlil_concrete_target_t, installation_id)
    MANIFEST_FIELD(ninlil_concrete_target_t, site_domain_id)
    MANIFEST_FIELD(ninlil_concrete_target_t, binding_epoch)
    MANIFEST_FIELD(ninlil_concrete_target_t, membership_epoch)
    MANIFEST_FIELD(ninlil_concrete_target_t, flags)
    MANIFEST_FIELD(ninlil_concrete_target_t, reserved_zero)
    MANIFEST_STRUCT_END(ninlil_concrete_target_t)
    MANIFEST_STRUCT_BEGIN(ninlil_service_identity_t)
    MANIFEST_FIELD(ninlil_service_identity_t, abi_version)
    MANIFEST_FIELD(ninlil_service_identity_t, struct_size)
    MANIFEST_FIELD(ninlil_service_identity_t, namespace_id)
    MANIFEST_FIELD(ninlil_service_identity_t, service_id)
    MANIFEST_FIELD(ninlil_service_identity_t, schema_id)
    MANIFEST_FIELD(ninlil_service_identity_t, descriptor_revision)
    MANIFEST_FIELD(ninlil_service_identity_t, descriptor_digest)
    MANIFEST_FIELD(ninlil_service_identity_t, schema_major)
    MANIFEST_FIELD(ninlil_service_identity_t, schema_minor)
    MANIFEST_FIELD(ninlil_service_identity_t, family)
    MANIFEST_STRUCT_END(ninlil_service_identity_t)
    MANIFEST_STRUCT_BEGIN(ninlil_bearer_message_t)
    MANIFEST_FIELD(ninlil_bearer_message_t, abi_version)
    MANIFEST_FIELD(ninlil_bearer_message_t, struct_size)
    MANIFEST_FIELD(ninlil_bearer_message_t, kind)
    MANIFEST_FIELD(ninlil_bearer_message_t, flags)
    MANIFEST_FIELD(ninlil_bearer_message_t, transaction_id)
    MANIFEST_FIELD(ninlil_bearer_message_t, attempt_id)
    MANIFEST_FIELD(ninlil_bearer_message_t, event_id)
    MANIFEST_FIELD(ninlil_bearer_message_t, source)
    MANIFEST_FIELD(ninlil_bearer_message_t, target)
    MANIFEST_FIELD(ninlil_bearer_message_t, service)
    MANIFEST_FIELD(ninlil_bearer_message_t, content_digest)
    MANIFEST_FIELD(ninlil_bearer_message_t, generation)
    MANIFEST_FIELD(ninlil_bearer_message_t, deadline_clock_epoch_id)
    MANIFEST_FIELD(ninlil_bearer_message_t, absolute_effect_deadline_ms)
    MANIFEST_FIELD(ninlil_bearer_message_t, evidence_grace_ms)
    MANIFEST_FIELD(ninlil_bearer_message_t, required_evidence)
    MANIFEST_FIELD(ninlil_bearer_message_t, receipt_stage)
    MANIFEST_FIELD(ninlil_bearer_message_t, disposition)
    MANIFEST_FIELD(ninlil_bearer_message_t, effect_certainty)
    MANIFEST_FIELD(ninlil_bearer_message_t, retry_guidance)
    MANIFEST_FIELD(ninlil_bearer_message_t, cancel_kind)
    MANIFEST_FIELD(ninlil_bearer_message_t, retry_delay_ms)
    MANIFEST_FIELD(ninlil_bearer_message_t, evidence_time)
    MANIFEST_FIELD(ninlil_bearer_message_t, payload)
    MANIFEST_FIELD(ninlil_bearer_message_t, evidence)
    MANIFEST_STRUCT_END(ninlil_bearer_message_t)
    MANIFEST_STRUCT_BEGIN(ninlil_bearer_send_result_t)
    MANIFEST_FIELD(ninlil_bearer_send_result_t, abi_version)
    MANIFEST_FIELD(ninlil_bearer_send_result_t, struct_size)
    MANIFEST_FIELD(ninlil_bearer_send_result_t, kind)
    MANIFEST_FIELD(ninlil_bearer_send_result_t, reserved_zero)
    MANIFEST_FIELD(ninlil_bearer_send_result_t, availability_epoch)
    MANIFEST_STRUCT_END(ninlil_bearer_send_result_t)
    MANIFEST_STRUCT_BEGIN(ninlil_bearer_state_t)
    MANIFEST_FIELD(ninlil_bearer_state_t, abi_version)
    MANIFEST_FIELD(ninlil_bearer_state_t, struct_size)
    MANIFEST_FIELD(ninlil_bearer_state_t, availability_epoch)
    MANIFEST_FIELD(ninlil_bearer_state_t, available)
    MANIFEST_FIELD(ninlil_bearer_state_t, reserved_zero)
    MANIFEST_STRUCT_END(ninlil_bearer_state_t)
    MANIFEST_STRUCT_BEGIN(ninlil_tx_permit_t)
    MANIFEST_FIELD(ninlil_tx_permit_t, abi_version)
    MANIFEST_FIELD(ninlil_tx_permit_t, struct_size)
    MANIFEST_FIELD(ninlil_tx_permit_t, permit_id)
    MANIFEST_FIELD(ninlil_tx_permit_t, attempt_id)
    MANIFEST_FIELD(ninlil_tx_permit_t, clock_epoch_id)
    MANIFEST_FIELD(ninlil_tx_permit_t, expires_at_ms)
    MANIFEST_STRUCT_END(ninlil_tx_permit_t)
    MANIFEST_STRUCT_BEGIN(ninlil_bearer_ops_t)
    MANIFEST_FIELD(ninlil_bearer_ops_t, abi_version)
    MANIFEST_FIELD(ninlil_bearer_ops_t, struct_size)
    MANIFEST_FIELD(ninlil_bearer_ops_t, user)
    MANIFEST_FIELD(ninlil_bearer_ops_t, open)
    MANIFEST_FIELD(ninlil_bearer_ops_t, close)
    MANIFEST_FIELD(ninlil_bearer_ops_t, send)
    MANIFEST_FIELD(ninlil_bearer_ops_t, receive_next)
    MANIFEST_FIELD(ninlil_bearer_ops_t, release_received)
    MANIFEST_FIELD(ninlil_bearer_ops_t, state)
    MANIFEST_STRUCT_END(ninlil_bearer_ops_t)
    MANIFEST_STRUCT_BEGIN(ninlil_tx_request_t)
    MANIFEST_FIELD(ninlil_tx_request_t, abi_version)
    MANIFEST_FIELD(ninlil_tx_request_t, struct_size)
    MANIFEST_FIELD(ninlil_tx_request_t, transaction_id)
    MANIFEST_FIELD(ninlil_tx_request_t, attempt_id)
    MANIFEST_FIELD(ninlil_tx_request_t, message_kind)
    MANIFEST_FIELD(ninlil_tx_request_t, logical_bytes)
    MANIFEST_FIELD(ninlil_tx_request_t, content_digest)
    MANIFEST_STRUCT_END(ninlil_tx_request_t)
    MANIFEST_STRUCT_BEGIN(ninlil_tx_gate_ops_t)
    MANIFEST_FIELD(ninlil_tx_gate_ops_t, abi_version)
    MANIFEST_FIELD(ninlil_tx_gate_ops_t, struct_size)
    MANIFEST_FIELD(ninlil_tx_gate_ops_t, user)
    MANIFEST_FIELD(ninlil_tx_gate_ops_t, acquire)
    MANIFEST_FIELD(ninlil_tx_gate_ops_t, release_unused)
    MANIFEST_STRUCT_END(ninlil_tx_gate_ops_t)
    MANIFEST_STRUCT_BEGIN(ninlil_origin_authorization_request_t)
    MANIFEST_FIELD(ninlil_origin_authorization_request_t, abi_version)
    MANIFEST_FIELD(ninlil_origin_authorization_request_t, struct_size)
    MANIFEST_FIELD(ninlil_origin_authorization_request_t, environment)
    MANIFEST_FIELD(ninlil_origin_authorization_request_t, reserved_zero)
    MANIFEST_FIELD(ninlil_origin_authorization_request_t, source)
    MANIFEST_FIELD(ninlil_origin_authorization_request_t, target)
    MANIFEST_FIELD(ninlil_origin_authorization_request_t, service)
    MANIFEST_FIELD(ninlil_origin_authorization_request_t, event_id)
    MANIFEST_FIELD(ninlil_origin_authorization_request_t, content_digest)
    MANIFEST_FIELD(ninlil_origin_authorization_request_t, required_evidence)
    MANIFEST_FIELD(ninlil_origin_authorization_request_t, payload_length)
    MANIFEST_FIELD(ninlil_origin_authorization_request_t, active_spool_count)
    MANIFEST_FIELD(ninlil_origin_authorization_request_t, admissions_in_current_window)
    MANIFEST_FIELD(ninlil_origin_authorization_request_t, active_spool_bytes)
    MANIFEST_FIELD(ninlil_origin_authorization_request_t, current_window_started_at_ms)
    MANIFEST_FIELD(ninlil_origin_authorization_request_t, now)
    MANIFEST_STRUCT_END(ninlil_origin_authorization_request_t)
    MANIFEST_STRUCT_BEGIN(ninlil_origin_authorization_decision_t)
    MANIFEST_FIELD(ninlil_origin_authorization_decision_t, abi_version)
    MANIFEST_FIELD(ninlil_origin_authorization_decision_t, struct_size)
    MANIFEST_FIELD(ninlil_origin_authorization_decision_t, allowed)
    MANIFEST_FIELD(ninlil_origin_authorization_decision_t, reason)
    MANIFEST_FIELD(ninlil_origin_authorization_decision_t, retry_guidance)
    MANIFEST_FIELD(ninlil_origin_authorization_decision_t, reserved_zero_head)
    MANIFEST_FIELD(ninlil_origin_authorization_decision_t, provider_id)
    MANIFEST_FIELD(ninlil_origin_authorization_decision_t, provider_revision)
    MANIFEST_FIELD(ninlil_origin_authorization_decision_t, decision_digest)
    MANIFEST_FIELD(ninlil_origin_authorization_decision_t, grant_id)
    MANIFEST_FIELD(ninlil_origin_authorization_decision_t, grant_revision)
    MANIFEST_FIELD(ninlil_origin_authorization_decision_t, clock_epoch_id)
    MANIFEST_FIELD(ninlil_origin_authorization_decision_t, evaluated_at_ms)
    MANIFEST_FIELD(ninlil_origin_authorization_decision_t, valid_from_ms)
    MANIFEST_FIELD(ninlil_origin_authorization_decision_t, expires_at_ms)
    MANIFEST_FIELD(ninlil_origin_authorization_decision_t, retry_delay_ms)
    MANIFEST_FIELD(ninlil_origin_authorization_decision_t, max_payload_bytes)
    MANIFEST_FIELD(ninlil_origin_authorization_decision_t, max_active_spool_count)
    MANIFEST_FIELD(ninlil_origin_authorization_decision_t, max_active_spool_bytes)
    MANIFEST_FIELD(ninlil_origin_authorization_decision_t, rate_window_ms)
    MANIFEST_FIELD(ninlil_origin_authorization_decision_t, max_admissions_per_window)
    MANIFEST_FIELD(ninlil_origin_authorization_decision_t, max_attempts_per_retry_cycle)
    MANIFEST_FIELD(ninlil_origin_authorization_decision_t, reserved_zero_tail)
    MANIFEST_STRUCT_END(ninlil_origin_authorization_decision_t)
    MANIFEST_STRUCT_BEGIN(ninlil_origin_authorization_ops_t)
    MANIFEST_FIELD(ninlil_origin_authorization_ops_t, abi_version)
    MANIFEST_FIELD(ninlil_origin_authorization_ops_t, struct_size)
    MANIFEST_FIELD(ninlil_origin_authorization_ops_t, user)
    MANIFEST_FIELD(ninlil_origin_authorization_ops_t, evaluate)
    MANIFEST_STRUCT_END(ninlil_origin_authorization_ops_t)
    MANIFEST_STRUCT_BEGIN(ninlil_platform_ops_t)
    MANIFEST_FIELD(ninlil_platform_ops_t, abi_version)
    MANIFEST_FIELD(ninlil_platform_ops_t, struct_size)
    MANIFEST_FIELD(ninlil_platform_ops_t, allocator)
    MANIFEST_FIELD(ninlil_platform_ops_t, execution)
    MANIFEST_FIELD(ninlil_platform_ops_t, clock)
    MANIFEST_FIELD(ninlil_platform_ops_t, entropy)
    MANIFEST_FIELD(ninlil_platform_ops_t, storage)
    MANIFEST_FIELD(ninlil_platform_ops_t, bearer)
    MANIFEST_FIELD(ninlil_platform_ops_t, tx_gate)
    MANIFEST_FIELD(ninlil_platform_ops_t, origin_authorization)
    MANIFEST_STRUCT_END(ninlil_platform_ops_t)
    MANIFEST_STRUCT_BEGIN(ninlil_service_descriptor_t)
    MANIFEST_FIELD(ninlil_service_descriptor_t, abi_version)
    MANIFEST_FIELD(ninlil_service_descriptor_t, struct_size)
    MANIFEST_FIELD(ninlil_service_descriptor_t, namespace_id)
    MANIFEST_FIELD(ninlil_service_descriptor_t, service_id)
    MANIFEST_FIELD(ninlil_service_descriptor_t, schema_id)
    MANIFEST_FIELD(ninlil_service_descriptor_t, descriptor_revision)
    MANIFEST_FIELD(ninlil_service_descriptor_t, descriptor_digest)
    MANIFEST_FIELD(ninlil_service_descriptor_t, local_application_instance_id)
    MANIFEST_FIELD(ninlil_service_descriptor_t, schema_major)
    MANIFEST_FIELD(ninlil_service_descriptor_t, schema_minor_min)
    MANIFEST_FIELD(ninlil_service_descriptor_t, schema_minor_max)
    MANIFEST_FIELD(ninlil_service_descriptor_t, reserved_zero_u16)
    MANIFEST_FIELD(ninlil_service_descriptor_t, family)
    MANIFEST_FIELD(ninlil_service_descriptor_t, direction)
    MANIFEST_FIELD(ninlil_service_descriptor_t, admission_authority)
    MANIFEST_FIELD(ninlil_service_descriptor_t, apply_contract)
    MANIFEST_FIELD(ninlil_service_descriptor_t, custody_policy)
    MANIFEST_FIELD(ninlil_service_descriptor_t, supported_evidence_mask)
    MANIFEST_FIELD(ninlil_service_descriptor_t, logical_payload_limit)
    MANIFEST_FIELD(ninlil_service_descriptor_t, target_limit)
    MANIFEST_FIELD(ninlil_service_descriptor_t, inflight_limit)
    MANIFEST_FIELD(ninlil_service_descriptor_t, max_attempts_per_target_per_cycle)
    MANIFEST_FIELD(ninlil_service_descriptor_t, admission_window_ms)
    MANIFEST_FIELD(ninlil_service_descriptor_t, max_admissions_per_window)
    MANIFEST_FIELD(ninlil_service_descriptor_t, max_payload_bytes_per_window)
    MANIFEST_FIELD(ninlil_service_descriptor_t, reserved_zero_u32)
    MANIFEST_FIELD(ninlil_service_descriptor_t, minimum_deadline_ms)
    MANIFEST_FIELD(ninlil_service_descriptor_t, maximum_deadline_ms)
    MANIFEST_FIELD(ninlil_service_descriptor_t, maximum_evidence_grace_ms)
    MANIFEST_FIELD(ninlil_service_descriptor_t, attempt_receipt_timeout_ms)
    MANIFEST_FIELD(ninlil_service_descriptor_t, retry_backoff_ms)
    MANIFEST_FIELD(ninlil_service_descriptor_t, application_completion_timeout_ms)
    MANIFEST_FIELD(ninlil_service_descriptor_t, required_dedup_window_ms)
    MANIFEST_STRUCT_END(ninlil_service_descriptor_t)
    MANIFEST_STRUCT_BEGIN(ninlil_delivery_view_t)
    MANIFEST_FIELD(ninlil_delivery_view_t, abi_version)
    MANIFEST_FIELD(ninlil_delivery_view_t, struct_size)
    MANIFEST_FIELD(ninlil_delivery_view_t, transaction_id)
    MANIFEST_FIELD(ninlil_delivery_view_t, attempt_id)
    MANIFEST_FIELD(ninlil_delivery_view_t, event_id)
    MANIFEST_FIELD(ninlil_delivery_view_t, source)
    MANIFEST_FIELD(ninlil_delivery_view_t, local_target)
    MANIFEST_FIELD(ninlil_delivery_view_t, service)
    MANIFEST_FIELD(ninlil_delivery_view_t, content_digest)
    MANIFEST_FIELD(ninlil_delivery_view_t, generation)
    MANIFEST_FIELD(ninlil_delivery_view_t, deadline_clock_epoch_id)
    MANIFEST_FIELD(ninlil_delivery_view_t, absolute_effect_deadline_ms)
    MANIFEST_FIELD(ninlil_delivery_view_t, evidence_grace_ms)
    MANIFEST_FIELD(ninlil_delivery_view_t, required_evidence)
    MANIFEST_FIELD(ninlil_delivery_view_t, delivery_count)
    MANIFEST_FIELD(ninlil_delivery_view_t, payload)
    MANIFEST_STRUCT_END(ninlil_delivery_view_t)
    MANIFEST_STRUCT_BEGIN(ninlil_application_result_t)
    MANIFEST_FIELD(ninlil_application_result_t, abi_version)
    MANIFEST_FIELD(ninlil_application_result_t, struct_size)
    MANIFEST_FIELD(ninlil_application_result_t, kind)
    MANIFEST_FIELD(ninlil_application_result_t, evidence_stage)
    MANIFEST_FIELD(ninlil_application_result_t, disposition)
    MANIFEST_FIELD(ninlil_application_result_t, reason)
    MANIFEST_FIELD(ninlil_application_result_t, effect_certainty)
    MANIFEST_FIELD(ninlil_application_result_t, retry_guidance)
    MANIFEST_FIELD(ninlil_application_result_t, retry_delay_ms)
    MANIFEST_FIELD(ninlil_application_result_t, evidence)
    MANIFEST_STRUCT_END(ninlil_application_result_t)
    MANIFEST_STRUCT_BEGIN(ninlil_reconcile_view_t)
    MANIFEST_FIELD(ninlil_reconcile_view_t, abi_version)
    MANIFEST_FIELD(ninlil_reconcile_view_t, struct_size)
    MANIFEST_FIELD(ninlil_reconcile_view_t, delivery)
    MANIFEST_FIELD(ninlil_reconcile_view_t, delivery_started_at_ms)
    MANIFEST_FIELD(ninlil_reconcile_view_t, prior_callback_invocations)
    MANIFEST_STRUCT_END(ninlil_reconcile_view_t)
    MANIFEST_STRUCT_BEGIN(ninlil_service_callbacks_t)
    MANIFEST_FIELD(ninlil_service_callbacks_t, abi_version)
    MANIFEST_FIELD(ninlil_service_callbacks_t, struct_size)
    MANIFEST_FIELD(ninlil_service_callbacks_t, user)
    MANIFEST_FIELD(ninlil_service_callbacks_t, on_delivery)
    MANIFEST_FIELD(ninlil_service_callbacks_t, on_reconcile)
    MANIFEST_STRUCT_END(ninlil_service_callbacks_t)
    MANIFEST_STRUCT_BEGIN(ninlil_submission_t)
    MANIFEST_FIELD(ninlil_submission_t, abi_version)
    MANIFEST_FIELD(ninlil_submission_t, struct_size)
    MANIFEST_FIELD(ninlil_submission_t, schema_major)
    MANIFEST_FIELD(ninlil_submission_t, schema_minor)
    MANIFEST_FIELD(ninlil_submission_t, reserved_zero)
    MANIFEST_FIELD(ninlil_submission_t, targets)
    MANIFEST_FIELD(ninlil_submission_t, target_count)
    MANIFEST_FIELD(ninlil_submission_t, required_evidence)
    MANIFEST_FIELD(ninlil_submission_t, effect_deadline_ms)
    MANIFEST_FIELD(ninlil_submission_t, evidence_grace_ms)
    MANIFEST_FIELD(ninlil_submission_t, idempotency_key)
    MANIFEST_FIELD(ninlil_submission_t, content_digest)
    MANIFEST_FIELD(ninlil_submission_t, event_id)
    MANIFEST_FIELD(ninlil_submission_t, generation)
    MANIFEST_FIELD(ninlil_submission_t, payload)
    MANIFEST_STRUCT_END(ninlil_submission_t)
    MANIFEST_STRUCT_BEGIN(ninlil_admission_assurance_t)
    MANIFEST_FIELD(ninlil_admission_assurance_t, abi_version)
    MANIFEST_FIELD(ninlil_admission_assurance_t, struct_size)
    MANIFEST_FIELD(ninlil_admission_assurance_t, assurance_profile)
    MANIFEST_FIELD(ninlil_admission_assurance_t, submission_validated)
    MANIFEST_FIELD(ninlil_admission_assurance_t, target_roster_fixed)
    MANIFEST_FIELD(ninlil_admission_assurance_t, descriptor_snapshot_fixed)
    MANIFEST_FIELD(ninlil_admission_assurance_t, local_journal_committed)
    MANIFEST_FIELD(ninlil_admission_assurance_t, local_capacity_reserved)
    MANIFEST_FIELD(ninlil_admission_assurance_t, idempotency_mapping_committed)
    MANIFEST_FIELD(ninlil_admission_assurance_t, origin_grant_snapshot_committed)
    MANIFEST_FIELD(ninlil_admission_assurance_t, remote_capacity_reserved)
    MANIFEST_FIELD(ninlil_admission_assurance_t, route_feasibility_verified)
    MANIFEST_FIELD(ninlil_admission_assurance_t, receive_window_reserved)
    MANIFEST_FIELD(ninlil_admission_assurance_t, bearer_capacity_reserved)
    MANIFEST_FIELD(ninlil_admission_assurance_t, airtime_reserved)
    MANIFEST_FIELD(ninlil_admission_assurance_t, compliance_permit_issued)
    MANIFEST_FIELD(ninlil_admission_assurance_t, reserved_zero)
    MANIFEST_STRUCT_END(ninlil_admission_assurance_t)
    MANIFEST_STRUCT_BEGIN(ninlil_submission_result_t)
    MANIFEST_FIELD(ninlil_submission_result_t, abi_version)
    MANIFEST_FIELD(ninlil_submission_result_t, struct_size)
    MANIFEST_FIELD(ninlil_submission_result_t, kind)
    MANIFEST_FIELD(ninlil_submission_result_t, reason)
    MANIFEST_FIELD(ninlil_submission_result_t, retry_guidance)
    MANIFEST_FIELD(ninlil_submission_result_t, reserved_zero)
    MANIFEST_FIELD(ninlil_submission_result_t, retry_delay_ms)
    MANIFEST_FIELD(ninlil_submission_result_t, transaction_id)
    MANIFEST_FIELD(ninlil_submission_result_t, canonical_submission_digest)
    MANIFEST_FIELD(ninlil_submission_result_t, assurance)
    MANIFEST_STRUCT_END(ninlil_submission_result_t)
    MANIFEST_STRUCT_BEGIN(ninlil_target_snapshot_t)
    MANIFEST_FIELD(ninlil_target_snapshot_t, abi_version)
    MANIFEST_FIELD(ninlil_target_snapshot_t, struct_size)
    MANIFEST_FIELD(ninlil_target_snapshot_t, target)
    MANIFEST_FIELD(ninlil_target_snapshot_t, state)
    MANIFEST_FIELD(ninlil_target_snapshot_t, outcome)
    MANIFEST_FIELD(ninlil_target_snapshot_t, reason)
    MANIFEST_FIELD(ninlil_target_snapshot_t, latest_evidence)
    MANIFEST_FIELD(ninlil_target_snapshot_t, attempt_in_cycle)
    MANIFEST_FIELD(ninlil_target_snapshot_t, retry_cycle_id)
    MANIFEST_FIELD(ninlil_target_snapshot_t, cumulative_attempts)
    MANIFEST_STRUCT_END(ninlil_target_snapshot_t)
    MANIFEST_STRUCT_BEGIN(ninlil_transaction_snapshot_t)
    MANIFEST_FIELD(ninlil_transaction_snapshot_t, abi_version)
    MANIFEST_FIELD(ninlil_transaction_snapshot_t, struct_size)
    MANIFEST_FIELD(ninlil_transaction_snapshot_t, transaction_id)
    MANIFEST_FIELD(ninlil_transaction_snapshot_t, event_id)
    MANIFEST_FIELD(ninlil_transaction_snapshot_t, source)
    MANIFEST_FIELD(ninlil_transaction_snapshot_t, service)
    MANIFEST_FIELD(ninlil_transaction_snapshot_t, content_digest)
    MANIFEST_FIELD(ninlil_transaction_snapshot_t, family)
    MANIFEST_FIELD(ninlil_transaction_snapshot_t, state)
    MANIFEST_FIELD(ninlil_transaction_snapshot_t, outcome)
    MANIFEST_FIELD(ninlil_transaction_snapshot_t, deadline_verdict)
    MANIFEST_FIELD(ninlil_transaction_snapshot_t, required_evidence)
    MANIFEST_FIELD(ninlil_transaction_snapshot_t, latest_evidence)
    MANIFEST_FIELD(ninlil_transaction_snapshot_t, reason)
    MANIFEST_FIELD(ninlil_transaction_snapshot_t, event_park_cause)
    MANIFEST_FIELD(ninlil_transaction_snapshot_t, generation)
    MANIFEST_FIELD(ninlil_transaction_snapshot_t, admission_clock_epoch_id)
    MANIFEST_FIELD(ninlil_transaction_snapshot_t, admitted_at_ms)
    MANIFEST_FIELD(ninlil_transaction_snapshot_t, deadline_clock_epoch_id)
    MANIFEST_FIELD(ninlil_transaction_snapshot_t, absolute_effect_deadline_ms)
    MANIFEST_FIELD(ninlil_transaction_snapshot_t, evidence_grace_ms)
    MANIFEST_FIELD(ninlil_transaction_snapshot_t, transaction_sequence)
    MANIFEST_FIELD(ninlil_transaction_snapshot_t, record_revision)
    MANIFEST_FIELD(ninlil_transaction_snapshot_t, event_spool_revision)
    MANIFEST_FIELD(ninlil_transaction_snapshot_t, target_count)
    MANIFEST_FIELD(ninlil_transaction_snapshot_t, target_capacity)
    MANIFEST_FIELD(ninlil_transaction_snapshot_t, targets)
    MANIFEST_FIELD(ninlil_transaction_snapshot_t, has_late_evidence)
    MANIFEST_FIELD(ninlil_transaction_snapshot_t, explicitly_discarded)
    MANIFEST_FIELD(ninlil_transaction_snapshot_t, assurance)
    MANIFEST_STRUCT_END(ninlil_transaction_snapshot_t)
    MANIFEST_STRUCT_BEGIN(ninlil_transaction_summary_t)
    MANIFEST_FIELD(ninlil_transaction_summary_t, abi_version)
    MANIFEST_FIELD(ninlil_transaction_summary_t, struct_size)
    MANIFEST_FIELD(ninlil_transaction_summary_t, transaction_id)
    MANIFEST_FIELD(ninlil_transaction_summary_t, service)
    MANIFEST_FIELD(ninlil_transaction_summary_t, family)
    MANIFEST_FIELD(ninlil_transaction_summary_t, state)
    MANIFEST_FIELD(ninlil_transaction_summary_t, outcome)
    MANIFEST_FIELD(ninlil_transaction_summary_t, reason)
    MANIFEST_FIELD(ninlil_transaction_summary_t, admission_clock_epoch_id)
    MANIFEST_FIELD(ninlil_transaction_summary_t, admitted_at_ms)
    MANIFEST_FIELD(ninlil_transaction_summary_t, transaction_sequence)
    MANIFEST_FIELD(ninlil_transaction_summary_t, record_revision)
    MANIFEST_STRUCT_END(ninlil_transaction_summary_t)
    MANIFEST_STRUCT_BEGIN(ninlil_query_t)
    MANIFEST_FIELD(ninlil_query_t, abi_version)
    MANIFEST_FIELD(ninlil_query_t, struct_size)
    MANIFEST_FIELD(ninlil_query_t, after_transaction_sequence)
    MANIFEST_FIELD(ninlil_query_t, admission_clock_epoch_id)
    MANIFEST_FIELD(ninlil_query_t, admitted_at_or_after_ms)
    MANIFEST_FIELD(ninlil_query_t, family_mask)
    MANIFEST_FIELD(ninlil_query_t, include_terminal)
    MANIFEST_FIELD(ninlil_query_t, include_nonterminal)
    MANIFEST_FIELD(ninlil_query_t, has_admitted_at_filter)
    MANIFEST_FIELD(ninlil_query_t, reserved_zero)
    MANIFEST_STRUCT_END(ninlil_query_t)
    MANIFEST_STRUCT_BEGIN(ninlil_transaction_page_t)
    MANIFEST_FIELD(ninlil_transaction_page_t, abi_version)
    MANIFEST_FIELD(ninlil_transaction_page_t, struct_size)
    MANIFEST_FIELD(ninlil_transaction_page_t, items)
    MANIFEST_FIELD(ninlil_transaction_page_t, item_capacity)
    MANIFEST_FIELD(ninlil_transaction_page_t, item_count)
    MANIFEST_FIELD(ninlil_transaction_page_t, next_after_transaction_sequence)
    MANIFEST_FIELD(ninlil_transaction_page_t, has_more)
    MANIFEST_FIELD(ninlil_transaction_page_t, reserved_zero)
    MANIFEST_STRUCT_END(ninlil_transaction_page_t)
    MANIFEST_STRUCT_BEGIN(ninlil_cancel_result_t)
    MANIFEST_FIELD(ninlil_cancel_result_t, abi_version)
    MANIFEST_FIELD(ninlil_cancel_result_t, struct_size)
    MANIFEST_FIELD(ninlil_cancel_result_t, kind)
    MANIFEST_FIELD(ninlil_cancel_result_t, reason)
    MANIFEST_FIELD(ninlil_cancel_result_t, current_outcome)
    MANIFEST_FIELD(ninlil_cancel_result_t, reserved_zero)
    MANIFEST_STRUCT_END(ninlil_cancel_result_t)
    MANIFEST_STRUCT_BEGIN(ninlil_event_resume_request_t)
    MANIFEST_FIELD(ninlil_event_resume_request_t, abi_version)
    MANIFEST_FIELD(ninlil_event_resume_request_t, struct_size)
    MANIFEST_FIELD(ninlil_event_resume_request_t, operation_id)
    MANIFEST_FIELD(ninlil_event_resume_request_t, actor_id)
    MANIFEST_FIELD(ninlil_event_resume_request_t, expected_spool_revision)
    MANIFEST_FIELD(ninlil_event_resume_request_t, resume_reason)
    MANIFEST_FIELD(ninlil_event_resume_request_t, reserved_zero)
    MANIFEST_FIELD(ninlil_event_resume_request_t, audit_metadata)
    MANIFEST_STRUCT_END(ninlil_event_resume_request_t)
    MANIFEST_STRUCT_BEGIN(ninlil_event_resume_result_t)
    MANIFEST_FIELD(ninlil_event_resume_result_t, abi_version)
    MANIFEST_FIELD(ninlil_event_resume_result_t, struct_size)
    MANIFEST_FIELD(ninlil_event_resume_result_t, kind)
    MANIFEST_FIELD(ninlil_event_resume_result_t, reason)
    MANIFEST_FIELD(ninlil_event_resume_result_t, operation_id)
    MANIFEST_FIELD(ninlil_event_resume_result_t, retry_cycle_id)
    MANIFEST_FIELD(ninlil_event_resume_result_t, spool_revision)
    MANIFEST_STRUCT_END(ninlil_event_resume_result_t)
    MANIFEST_STRUCT_BEGIN(ninlil_event_discard_request_t)
    MANIFEST_FIELD(ninlil_event_discard_request_t, abi_version)
    MANIFEST_FIELD(ninlil_event_discard_request_t, struct_size)
    MANIFEST_FIELD(ninlil_event_discard_request_t, operation_id)
    MANIFEST_FIELD(ninlil_event_discard_request_t, actor_id)
    MANIFEST_FIELD(ninlil_event_discard_request_t, expected_event_id)
    MANIFEST_FIELD(ninlil_event_discard_request_t, expected_content_digest)
    MANIFEST_FIELD(ninlil_event_discard_request_t, expected_spool_revision)
    MANIFEST_FIELD(ninlil_event_discard_request_t, discard_reason)
    MANIFEST_FIELD(ninlil_event_discard_request_t, acknowledge_required_receipt_absent)
    MANIFEST_FIELD(ninlil_event_discard_request_t, audit_metadata)
    MANIFEST_STRUCT_END(ninlil_event_discard_request_t)
    MANIFEST_STRUCT_BEGIN(ninlil_event_discard_result_t)
    MANIFEST_FIELD(ninlil_event_discard_result_t, abi_version)
    MANIFEST_FIELD(ninlil_event_discard_result_t, struct_size)
    MANIFEST_FIELD(ninlil_event_discard_result_t, kind)
    MANIFEST_FIELD(ninlil_event_discard_result_t, reason)
    MANIFEST_FIELD(ninlil_event_discard_result_t, operation_id)
    MANIFEST_FIELD(ninlil_event_discard_result_t, audit_clock_epoch_id)
    MANIFEST_FIELD(ninlil_event_discard_result_t, audit_committed_at_ms)
    MANIFEST_FIELD(ninlil_event_discard_result_t, spool_revision)
    MANIFEST_FIELD(ninlil_event_discard_result_t, spool_released)
    MANIFEST_FIELD(ninlil_event_discard_result_t, reserved_zero)
    MANIFEST_STRUCT_END(ninlil_event_discard_result_t)
    MANIFEST_STRUCT_BEGIN(ninlil_resource_limits_t)
    MANIFEST_FIELD(ninlil_resource_limits_t, abi_version)
    MANIFEST_FIELD(ninlil_resource_limits_t, struct_size)
    MANIFEST_FIELD(ninlil_resource_limits_t, max_services)
    MANIFEST_FIELD(ninlil_resource_limits_t, max_nonterminal_transactions)
    MANIFEST_FIELD(ninlil_resource_limits_t, max_targets_per_transaction)
    MANIFEST_FIELD(ninlil_resource_limits_t, max_logical_payload_bytes)
    MANIFEST_FIELD(ninlil_resource_limits_t, max_durable_outbox_payload_bytes)
    MANIFEST_FIELD(ninlil_resource_limits_t, max_attempts_per_target_per_cycle)
    MANIFEST_FIELD(ninlil_resource_limits_t, max_cancel_attempts_per_transaction)
    MANIFEST_FIELD(ninlil_resource_limits_t, max_evidence_per_target)
    MANIFEST_FIELD(ninlil_resource_limits_t, max_retained_terminal_transactions)
    MANIFEST_FIELD(ninlil_resource_limits_t, max_nonterminal_deliveries)
    MANIFEST_FIELD(ninlil_resource_limits_t, max_event_spool_count)
    MANIFEST_FIELD(ninlil_resource_limits_t, max_event_spool_bytes)
    MANIFEST_FIELD(ninlil_resource_limits_t, max_result_cache_entries)
    MANIFEST_FIELD(ninlil_resource_limits_t, max_retained_dispositions)
    MANIFEST_FIELD(ninlil_resource_limits_t, max_ingress_per_step)
    MANIFEST_FIELD(ninlil_resource_limits_t, max_callbacks_per_step)
    MANIFEST_FIELD(ninlil_resource_limits_t, max_state_transitions_per_step)
    MANIFEST_FIELD(ninlil_resource_limits_t, max_bearer_sends_per_step)
    MANIFEST_FIELD(ninlil_resource_limits_t, max_deferred_tokens)
    MANIFEST_FIELD(ninlil_resource_limits_t, reserved_zero)
    MANIFEST_STRUCT_END(ninlil_resource_limits_t)
    MANIFEST_STRUCT_BEGIN(ninlil_runtime_config_t)
    MANIFEST_FIELD(ninlil_runtime_config_t, abi_version)
    MANIFEST_FIELD(ninlil_runtime_config_t, struct_size)
    MANIFEST_FIELD(ninlil_runtime_config_t, role)
    MANIFEST_FIELD(ninlil_runtime_config_t, environment)
    MANIFEST_FIELD(ninlil_runtime_config_t, runtime_id)
    MANIFEST_FIELD(ninlil_runtime_config_t, local_identity)
    MANIFEST_FIELD(ninlil_runtime_config_t, storage_namespace)
    MANIFEST_FIELD(ninlil_runtime_config_t, limits)
    MANIFEST_FIELD(ninlil_runtime_config_t, terminal_retention_ms)
    MANIFEST_FIELD(ninlil_runtime_config_t, result_cache_retention_ms)
    MANIFEST_FIELD(ninlil_runtime_config_t, observation_retention_ms)
    MANIFEST_FIELD(ninlil_runtime_config_t, reserved_zero)
    MANIFEST_STRUCT_END(ninlil_runtime_config_t)
    MANIFEST_STRUCT_BEGIN(ninlil_step_budget_t)
    MANIFEST_FIELD(ninlil_step_budget_t, abi_version)
    MANIFEST_FIELD(ninlil_step_budget_t, struct_size)
    MANIFEST_FIELD(ninlil_step_budget_t, max_ingress_messages)
    MANIFEST_FIELD(ninlil_step_budget_t, max_callbacks)
    MANIFEST_FIELD(ninlil_step_budget_t, max_state_transitions)
    MANIFEST_FIELD(ninlil_step_budget_t, max_bearer_sends)
    MANIFEST_STRUCT_END(ninlil_step_budget_t)
    MANIFEST_STRUCT_BEGIN(ninlil_step_result_t)
    MANIFEST_FIELD(ninlil_step_result_t, abi_version)
    MANIFEST_FIELD(ninlil_step_result_t, struct_size)
    MANIFEST_FIELD(ninlil_step_result_t, ingress_processed)
    MANIFEST_FIELD(ninlil_step_result_t, callbacks_invoked)
    MANIFEST_FIELD(ninlil_step_result_t, state_transitions)
    MANIFEST_FIELD(ninlil_step_result_t, bearer_sends)
    MANIFEST_FIELD(ninlil_step_result_t, transactions_terminalized)
    MANIFEST_FIELD(ninlil_step_result_t, events_parked)
    MANIFEST_FIELD(ninlil_step_result_t, more_work)
    MANIFEST_FIELD(ninlil_step_result_t, has_next_wake)
    MANIFEST_FIELD(ninlil_step_result_t, next_wake_clock_epoch_id)
    MANIFEST_FIELD(ninlil_step_result_t, next_wake_at_ms)
    MANIFEST_FIELD(ninlil_step_result_t, health)
    MANIFEST_FIELD(ninlil_step_result_t, degraded_reason)
    MANIFEST_FIELD(ninlil_step_result_t, reserved_zero)
    MANIFEST_STRUCT_END(ninlil_step_result_t)
    MANIFEST_STRUCT_BEGIN(ninlil_capacity_entry_t)
    MANIFEST_FIELD(ninlil_capacity_entry_t, abi_version)
    MANIFEST_FIELD(ninlil_capacity_entry_t, struct_size)
    MANIFEST_FIELD(ninlil_capacity_entry_t, kind)
    MANIFEST_FIELD(ninlil_capacity_entry_t, reserved_zero)
    MANIFEST_FIELD(ninlil_capacity_entry_t, limit)
    MANIFEST_FIELD(ninlil_capacity_entry_t, used)
    MANIFEST_FIELD(ninlil_capacity_entry_t, reserved)
    MANIFEST_FIELD(ninlil_capacity_entry_t, high_water)
    MANIFEST_FIELD(ninlil_capacity_entry_t, capacity_epoch)
    MANIFEST_STRUCT_END(ninlil_capacity_entry_t)
    MANIFEST_STRUCT_BEGIN(ninlil_capacity_snapshot_t)
    MANIFEST_FIELD(ninlil_capacity_snapshot_t, abi_version)
    MANIFEST_FIELD(ninlil_capacity_snapshot_t, struct_size)
    MANIFEST_FIELD(ninlil_capacity_snapshot_t, entries)
    MANIFEST_FIELD(ninlil_capacity_snapshot_t, entry_capacity)
    MANIFEST_FIELD(ninlil_capacity_snapshot_t, entry_count)
    MANIFEST_STRUCT_END(ninlil_capacity_snapshot_t)
    MANIFEST_STRUCT_BEGIN(ninlil_metrics_snapshot_t)
    MANIFEST_FIELD(ninlil_metrics_snapshot_t, abi_version)
    MANIFEST_FIELD(ninlil_metrics_snapshot_t, struct_size)
    MANIFEST_FIELD(ninlil_metrics_snapshot_t, metrics_epoch_id)
    MANIFEST_FIELD(ninlil_metrics_snapshot_t, started_clock_epoch_id)
    MANIFEST_FIELD(ninlil_metrics_snapshot_t, started_at_ms)
    MANIFEST_FIELD(ninlil_metrics_snapshot_t, submission_calls)
    MANIFEST_FIELD(ninlil_metrics_snapshot_t, admitted_ready)
    MANIFEST_FIELD(ninlil_metrics_snapshot_t, already_admitted)
    MANIFEST_FIELD(ninlil_metrics_snapshot_t, rejected)
    MANIFEST_FIELD(ninlil_metrics_snapshot_t, idempotency_conflicts)
    MANIFEST_FIELD(ninlil_metrics_snapshot_t, transactions_satisfied)
    MANIFEST_FIELD(ninlil_metrics_snapshot_t, transactions_expired)
    MANIFEST_FIELD(ninlil_metrics_snapshot_t, transactions_failed_definitive)
    MANIFEST_FIELD(ninlil_metrics_snapshot_t, transactions_outcome_unknown)
    MANIFEST_FIELD(ninlil_metrics_snapshot_t, events_parked)
    MANIFEST_FIELD(ninlil_metrics_snapshot_t, events_resumed)
    MANIFEST_FIELD(ninlil_metrics_snapshot_t, events_discarded)
    MANIFEST_FIELD(ninlil_metrics_snapshot_t, late_evidence)
    MANIFEST_FIELD(ninlil_metrics_snapshot_t, duplicate_logical_delivery)
    MANIFEST_FIELD(ninlil_metrics_snapshot_t, application_callback_invocations)
    MANIFEST_FIELD(ninlil_metrics_snapshot_t, reconcile_invocations)
    MANIFEST_FIELD(ninlil_metrics_snapshot_t, delivery_token_timeouts)
    MANIFEST_FIELD(ninlil_metrics_snapshot_t, storage_failures)
    MANIFEST_FIELD(ninlil_metrics_snapshot_t, bearer_would_block)
    MANIFEST_STRUCT_END(ninlil_metrics_snapshot_t)
